<?

$project_news = array(
array("July 22, 2006",
    "BOINC user survey:
    due to a bug in our software, answers to the question
    'Which are the most important factors when you decide whether to participate in a BOINC project?' were not recorded correctly.
    Please <a href=poll.php>fill out the survey form again</a>.
    We apologize for the inconvenience."
),
array("July 21, 2006",
    "The BOINC survey is now available in
    <a href=http://boinc.oocp.org/poll.php>Japanese</a>.
    If you'd like to translate it to another language,
    please <a href=contact.php>contact us</a>."
),
array("July 13, 2006",
    "We are conducting an <a href=poll.php>online survey</a>
    of BOINC participants.
    Please fill out the survey form -
    your responses will help us improve BOINC and the projects that use it. "
),
array("July 13, 2006",
    "Articles in
    <a href=http://www.nature.com/news/2006/060717/full/060717-15.html>Nature</a>,
    <a href=http://www.economist.com/science/displayStory.cfm?story_id=7159442>The Economist</a>
    and <a href=http://www.webwire.com/ViewPressRel.asp?aId=16636>WebWire</a>
    describe <a href=http://africa-at-home.web.cern.ch/>Africa@home</a>,
    an initiative that supports African humanitarian causes.
    Their first BOINC-based project,
    <a href=http://www.malariacontrol.net/>malariacontrol.net</a>,
    studies malaria epidemiology.
    Africa@home is a collaboration of the Swiss Tropical Institute,
    CERN, and a group of universities (three of them from Africa).
    "
),
array("July 7, 2006",
    "The <a href=http://issofty17.is.noda.tus.ac.jp/>TANPAKU</a>
    project, based at the Tokyo University of Science,
    is open for participation.
    TANPAKU (from the Japanese word <i>tanpaku-shitsu</i>,
    meaning 'protein') studies protein structure and function
    using a novel method called Brownian Dynamics."
),
array("June 30, 2006",
    "Want to deploy BOINC quickly and easily on a Windows network?
    Read <a href=http://www.thelazyslug.com/boinc.htm>The Lazy Slug's Guide
    to easy deployment and maintenance of BOINC on your network</a>."
),
array("June 29, 2006",
    "<a href=http://boinc.berkeley.edu/boinc_papers/api/text.pdf>A
    paper about BOINC's API and runtime system</a>
    will appear in the <a href=http://sc06.supercomp.org>SC06 conference</a>."
),
array("June 28, 2006",
    "A new <a href=sandbox_user.php>Secure BOINC Client</a>
    for the Macintosh is available for testing.
    This version limits BOINC applications' access to your system and data,
    thus protecting your computer from accidental or malicious damage
    or data theft."
),
array("June 22, 2006",
    "Pav Lucistnik has developed
    <a href=http://www.oook.cz/bsd/boinc_curses/>boinc_curses</a>,
    a Unix console-based program (like 'top')
    to monitor and control BOINC."
),
array("June 21, 2006",
    "BOINCstats and the BAM! account manager
    are now available <a href=http://jp.boincstats.com>in Japanese</a>."
),
array("June 15, 2006",
    "BOINC's CPU scheduler has become smarter:
    it now waits until an application has checkpointed
    to preempt it and remove it from memory.
    This can save significant CPU time, especially on multiprocessors.
    Technical details are <a href=sched.php>here</a>.
    The new scheduler is in the development version of BOINC,
    and will appear in the 5.6 release.
    Volunteer developer John McLeod VII was the driving
    force behind the new scheduler."
),
array("June 14, 2006",
    "We have added preliminary support for
    <a href=wrapper.php>legacy applications</a>
    that do not use the BOINC API
    (e.g. because their source code is not available).
    This feature will work with the next version
    (5.6) of the BOINC client software.
    "
),
array("June 10, 2006",
    "The <a href=http://www.boincuk.com/newsletter_reg.php>BOINC UK Newsletter Circuler</a> (bunc) has released its June 2006 edition,
    featuring an interview with David Anderson."
),
array("June 7, 2006",
    "Windows users: if BOINC applications are repeatedly
    crashing on your computer,
    it's possibly that you need to
    <a href=directx.php>upgrade to the latest version of DirectX</a>."
),
array("May 31, 2006",
    "Recent newspaper articles on BOINC and Rosetta@home:
    <a href=http://seattletimes.nwsource.com/html/localnews/2003027071_computersider30m.html>Worldwide, 690,000 help computer effort</a> and
    <a href=http://seattlepi.nwsource.com/local/6420AP_WA_Research_at_Home.html>Medical researcher taps the power of home computing</a>."
),
array("May 30, 2006",
    "The <a href=http://bam.boincstats.com>BOINCStats Account Manager</a>
    (BAM!) is now available for use.
    BAM! provides 'one-stop shopping' for finding
    and attaching to BOINC project;
    see the news item of May 11.
    Thanks to Willy de Zutter for developing BAM!."
),
array("May 25, 2006",
    "BOINC has added preliminary support for 'low-latency' computing;
    e.g. delay bounds of minutes rather than days.
    This requires having clients contact the server frequently;
    we've added a mechanism that lets the server specify
    the connection interval.
    This will be available in the next release (5.6) of the client software.
    Projects that are interested in using this mechanism should
    <a href=contact.php>contact us</a>."
),
array("May 17, 2006",
    "The costs of electricity, both monetary and environmental, are high.
    Be aware of the <a href=energy.php>energy considerations</a>
    associated with BOINC and volunteer computing."
),
array("May 11, 2006",
    "Version 5.4 of the BOINC client software has been released.
    This version lets you use <a href=acct_mgt.php>account managers</a> -
    special web sites that let you browse BOINC projects,
    attach/detach, change resource share and settings,
    all with point-and-click simplicity.
    Account managers are also great if you have several computers -
    you make changes on the web site,
    and they take effect on all of your computers.
    A couple of excellent account managers are nearly ready for use;
    stay tuned for details."
),
array("May 9, 2006",
    "The first-ever
    <a href=http://www.seti.cat/web/?q=node/18>BOINC birthday cake</a>
    appeared at the 7th SETI@home-Catalonia Meeting
    (and 1st BOINC-Catalonia Meeting), held in Girona last April 22nd.
    Also: <a href=http://www.boinc.cat>BOINC.cat</a>,
    a BOINC site in Catalan, has recently opened.
"),
array("April 30, 2006",
    "<img align=right width=75 height=66 src=images/Logo_blau.jpg> The latest German <a href=http://boinccast.podhost.de/>BOINCcast</a>
    discusses ClimatePrediction.net;
    earlier BOINCcasts cover SIMAP, LHC@home, and uFluids.
    <br>
    "
),
array("April 14, 2006",
    "The CERN Courier's Computer Newsletter features an article on
    <a href=http://www.cerncourier.com/articles/cnl/3/4/14/1>BOINC activities at CERN</a>.
"),
array("April 13, 2006",
    "According to various <a href=links.php>statistics sites</a>,
    over one million computers have now contributed
    processing power to BOINC projects.
    We're currently achieving a sustained processing rate
    of over 400 TeraFLOPS - the world's most powerful supercomputer
    by a wide margin.
    Congratulations and thanks to everyone!
"),
array("April 13, 2006",
    "We have developed an <a href=example.php>example application</a>,
    together with project files and Makefiles for Windows, Mac, and Linux.
    The application demonstrates how to do checkpoint/restart and graphics.
    Projects can use this as a framework for building their own applications.
"),
array("April 6, 2006",
    "Thanks to the efforts of
    <a href=http://alioth.debian.org/projects/pkg-boinc/>volunteers</a>,
    BOINC is now officially part of the Debian Linux distribution.
    Packages for the BOINC
    <a href=http://packages.debian.org/boinc-client>core client</a>
    and <a href=http://packages.debian.org/boinc-manager>Manager</a>
    are available for 13 different platforms
    (alpha, amd64, arm, hppa, 
    i386, ia64, kfreebsd-i386, m68k, mips, mipsel, powerpc, s390 and sparc).
"),
array("April 4, 2006",
    "Windows users: new versions of
    <a href=http://www.microsoft.com/hardware/mouseandkeyboard/DownloadResult.aspx?prod=m_wom20&os=xp&lang=en&driverVersion=IntelliPoint%205.5>Intellipoint</a>
    and <a href=http://www.microsoft.com/hardware/mouseandkeyboard/DownloadResult.aspx?prod=m_wNMK&os=xp&lang=en&driverVersion=IntelliType%20Pro%205.5>Intellitype</a>
    are available from Microsoft.
    Upgrading to these may fix problems with the BOINC screensaver.
    "
),
array("April 3, 2006",
    "<a href=http://boincstats.com>BOINCstats.com</a> is one of
    several excellent web sites showing BOINC statistics.
    It's available in a number of languages, now including
    <a href=http://cn.boincstats.com/>Chinese</a>.
    "
),
array("March 15, 2006",
    "The <a href=http://attribution.cpdn.org/>Seasonal Attribution Project</a>,
    a spin-off of Climateprediction.net,
    seeks to determine the extent to which extreme weather events
    are attributable to human-induced climate change.
    Its application is a high-resolution simulation of the world's climate,
    and is recommended only for computers
    with at least 1 GB of RAM, and a 2.4GHz Pentium or faster processor.
    "
),
array("March 5, 2006",
    "Tony/Knightrider/Chuggybus has created BOINC coinage.
    See the <a href=images/coins/>large</a>
    and <a href=images/coins_small>small</a> versions.
    The Latin text means 'Berkeley open and shared resources'.
    "
),
array("March 3, 2006",
    "<a href=http://qah.uni-muenster.de/>Quantum Monte Carlo at Home</a>
    announces the public release of the first chemistry BOINC project.
    This project, based at the University of M&uuml;nster in Germany,
    studies the structure and reactivity of molecules using Quantum Chemistry,
    whose vastly complex equations require huge amounts of computing power.
    "
),
array("February 24, 2006",
    "A significant step has been made towards integrating
    BOINC and Grid software:
    beginning with Condor version 6.7.17,
    Condor can be configured to run BOINC when it has no other work to perform.
    This capability is described in <a href=http://www.cs.wisc.edu/condor/manual/v6.7/3_13Setting_Up.html#SECTION004138000000000000000>the Condor manual</a>.
    "
),
array("February 22, 2006",
    "BOINC announces its
    <a href=mac_intel.php>support for the Macintosh/Intel platform</a>.
    "
),
array("February 19, 2006",
    "<a href=http://boinccast.podhost.de/>BOINCcast</a>
    is the first German Podcast about BOINC.
    Weekly episodes of 5 minutes length will explain Distributed Computing
    and the Goals of BOINC to the German public,
    and will present and explain the projects that use BOINC.
    "
),
array("February 15, 2006",
    "View <a href=http://news.bbc.co.uk/nolavconsole/ukfs_news/hi/newsid_4710000/newsid_4713000/bb_rm_4713004.stm>a video clip</a>
    about the BBC Climate Change Experiment.
    "
),
array("February 14, 2006",
    "BOINC and Climateprediction.net have joined forces with the BBC
    to launch a new experiment -- a full simulation of climate change
    from 1920 to 2080.
    The experiment is described on
    a BBC television documentary <b>Meltdown</b>
    (BBC-4, February 20th, for UK BOINCers).
    Simplified client software is available
    at <a href=http://bbc.co.uk/climatechange>bbc.co.uk/climatechange</a>.
    Experienced BOINCers can attach to http://bbc.cpdn.org
    (check out the new graphics!).
    Be warned that a 160-year climate simulation is a long workunit even
    by Climateprediction.net's extravagant standards.
    But if you have a fast machine and are prepared to give
    us first call on your CPU, just for the next couple of months,
    then you could see your results in a second BBC television programme
    scheduled for May.
    "
),
array("February 8, 2006",
    "The <a href=http://szdg.lpds.sztaki.hu/szdg/>SZTAKI Desktop Grid</a>
    is now in production.
    The project, based at the MTA-SZTAKI Laboratory of Parallel
    and Distributed Systems in Budapest, Hungary, is attempting
    to find all the generalized binary number systems
    (bases are matrices and digits are vectors) up to dimension 11."
),
array("February 6, 2006",
    "The <a href=http://boinc.bio.wzw.tum.de/boincsimap/>Similarity
    Matrix of Proteins (SIMAP)</a> project is now in production.
    SIMAP, based at the Technical University of Munich,
    uses volunteer computers to calculate similarities between proteins.
    It provides a public database of the resulting data,
    which plays a key role in many bioinformatics research projects.
    SIMAP is the first German BOINC-based project."
),
array("December 15, 2005",
    "A <a href=http://www.nature.com/news/2005/051212/full/051212-10.html>story
    about SETI@home's transition to BOINC</a> appears in the Nature web site."
),
array("December 12, 2005",
    "A new paper, <a href=http://boinc.berkeley.edu/boinc_papers/internet/paper.pdf>The Computational and Storage Potential of Volunteer Computing</a>,
    explores the limits of BOINC-based projects."
),
array("December 9, 2005",
    "BOINC has a job opening for an experienced programmer
    (C++/Python/PHP/SQL/HTML).
    For more information go to
    <a href=http://jobs.berkeley.edu/> http://jobs.berkeley.edu/</a>.
    The job is number 003496, and is listed under Information Technology."
),
array("November 29, 2005",
    "We have created a new email list,
    <a href=http://www.ssl.berkeley.edu/mailman/listinfo/boinc_announce>boinc_announce@ssl.berkeley.edu</a>,
    for announcements of new versions of BOINC client software."
),
array("November 27, 2005",
     "Check out <a href=https://uimon.cern.ch/twiki/pub/LHCAtHome/LinksAndDocs/boincciemat06.pdf>A BOINC seminar by Juan Antonio Lopez Perez of CERN</a>,
     presented at CIEMAT in Madrid, November 2005.
     Also available in a
     <a href=https://uimon.cern.ch/twiki/pub/LHCAtHome/LinksAndDocs/boincciematprint06.pdf>print version</a>."
),
array("November 15, 2005",
    "<a href=stats.php>Aggregate credit data</a>
    (user and host credit data summed over all BOINC projects)
    is now available in XML format.
    This data can be used for applications
    (like the 'Featured participant' above)
    that reflect overall contribution to BOINC project.
    "
),
array("November 1, 2005",
    "IBM's <a href=http://www.worldcommunitygrid.org/>World Community Grid</a>
    has launched a BOINC-based project (currenly Linux only)."
),
array("October 28, 2005",
    "David Anderson talks about BOINC and volunteer computing
    in a <a href=http://www.enterpriseleadership.org/listen/podcast-anderson>podcast at www.enterpriseleadership.org</a>."
),
array("October 20, 2005",
    "Version 5.2.2 of the BOINC client software has been released.
    It includes a simpler registration procedure,
    security enhancements, and numerous other improvements."
),
array("September 25, 2005",
    "<a href=http://boinc.bakerlab.org/rosetta/>Rosetta@home<a>,
    a BOINC-based project at the University of Washington,
    has launched and is seeking participants.
    Its goal is \"... to develop methods that accurately
    predict and design protein structures
    and complexes, an endeavor that may ultimately help researchers
    develop cures for human diseases.\""
),
array("September 23, 2005",
    "<a href=server_perf.pdf>High-Performance Task Distribution for Volunteer Computing</a>, a paper about BOINC server performance,
    will appear in the e-Science 2005 conference in December."
),
array("September 6, 2005",
    "<a href=http://www.theinstitute.ieee.org/portal/site/tionline/menuitem.130a3558587d56e8fb2275875bac26c8/index.jsp?&pName=institute_level1_article&TheCat=2201&article=tionline/legacy/inst2005/sep05/9w.fgravity.xml&>Searching for Gravity @ Home</a>, an article about Einstein@home and BOINC,
    appears in the September 2005 issue of IEEE's <i>The Institute</i>."
),
array("August 29, 2005",
    "<a href=http://www.acmqueue.com/modules.php?name=Content&pa=showpage&pid=313>A conversation with David Anderson</a> in ACM Queue Magazine."
),
array("August 14, 2005",
    "We are <a href=new_setup.php>redesigning BOINC</a> to use
    a user-supplied identifier and password
    instead of a system-supplied random key
    for identifying an account.
    Comments on the design are welcome."
),
array("August 9, 2005",
    "BOINC is transitioning to use <a href=http://curl.haxx.se/>libcurl</a>
    for HTTP operations.
    This will allow BOINC to use HTTPS (secure HTTP)
    for scheduler requests and file transfers."
),
array("August 3, 2005",
    "Non-open-source code (RSAEuro and GLUT) has been removed from BOINC.
    OpenSSL's crypto library is used for encryption."
),

array("July 25, 2005", 
    "A group of students from Cornell have written
    <a href=distributing_science_final.pdf>Distributing Science</a>,
    a very nice article about BOINC
    and some of the projects using it."
),
array("July 24, 2005",
    "<a href=http://www.fatbat.dk/thesis/>A paper by Jakob Pedersen and Christian S&#248;ttrup</a>
    discusses the interoperation of the Grid and BOINC."
),

array("July 11-12, 2005",
    "The <a href=cern_workshop.php>First Pangalactic BOINC Workshop</a>
    was held at CERN,
    bringing together people from ClimatePrediction.net,
    Einstein@home, CERN, and BOINC.
    "
),
array("June 25, 2005",
    "BOINC <a href=stats_sites.php>statistics</a> sites continue to evolve.
    Check out <a href=http://home.btconnect.com/Gabys_Bazar/hwupgrade.html>Every Earthly Hour</a>, developed by Hydnum Repandum"
),
array("June 24, 2005",
    "We have added
    <a href=http://boinc.berkeley.edu/api.php#credit>new API calls</a>
    that allow applications to do their own CPU benchmarking,
    or directly report their floating-point operation count.
    This will give more accurate credit numbers for
    applications that are optimized for specific architectures
    or that use non-CPU computing resources such as GPUs."
),
array("June 24, 2005",
    "We've added two mechanisms that give better estimates
    of result completion time
    (and thus better scheduling and fewer missed deadlines):
    1) we track the 'CPU efficiency': the average fraction
    of CPU time that BOINC apps receive while they're running
    (this can be less than one on systems that run
    compute-intensive tasks other than BOINC);
    2) we dynamically maintain a per-project upper bound on the
    ratio of actual CPU time to predicted CPU time."
),
array("June 24, 2005",
    "We've improved and simplified the CPU scheduling and work-fetch policies,
    using a detailed simulation of BOINC's weighted round-robin scheduling.
    When the simulator predicts that a deadline will be missed,
    the client switches to earliest-deadline-first scheduling.
    When the simulator predicts that fetching additional work
    will cause a deadline to be missed, it suspends work fetch."
),
array("June 24, 2005",
    "<a href=acct_mgt.php>Account management system</a>
    are web sites that let participants sign up for
    multiple projects with just a few clicks (and no account keys).
    The BOINC manager (development version) now lets you
    select, change, or get updated account info from an account manager."
),
array("June 24, 2005",
    "BOINC now works in Windows 'service' mode on computers
    with dialup connections and the 'confirm before connect' preference set.
    The connection confirmation and setup process has been
    moved to the BOINC manager, which (unlike a service)
    is able to do GUI activities."
),

array("June 16, 2005",
    "Climateprediction.net is featured in
    <a href=http://www.iee.org/oncomms/sector/PN_Article.cfm?objectID=3D100A5C-BC75-D279-D8D15A49EC4131B4>an article</a>
    in the journal of the Institute of Electrical Engineers."
),
array("June 3, 2005",
    "Two Wiki-based BOINC informational sites have been launched recently:
    <a href=http://boinc-doc.net/boinc-wiki/>The Unofficial BOINC Wiki</a>
    (in English) and
    <a href=http://faq.boinc.de/>Deutsche BOINC FAQ</a> (in German).
    Because these sites are Wikis,
    participants can add and modify content."
),
array("May 31, 2005",
    "BOINC is featured in <a href=http://sciencereview.berkeley.edu:7066/pdf/5.1/briefs_pt3.pdf>The Berkeley Science Review</a>."
),
array("May 14, 2005",
    "Eric Myers and Charlie Fenton have written
    excellent documents on
    <a href=compile.php>how to compile BOINC and BOINC applications
    on Windows, Linux, and Mac OS X</a>."
),
array("May 11, 2005",
    "BOINC and BOINC-based projects are discussed in
    the article 'Grassroots Computing'
    in the May 6 2005 issue of
    <a href=http://www.sciencemag.org/sciext/computers/>Science magazine</a>."
),
array("May 10, 2005",
    "LHC@home is a BOINC-based project being used to
    simulate the orbits of particles in CERN's Large Hadron Collider (LHC).
    Read about it in the
    <a href=http://bulletin.cern.ch/eng/articles.php?bullno=13/2005&base=art#Article1>CERN Bulletin</a>.
    "
),
array("May 10, 2005",
    "As the number of BOINC-based projects has increased,
    a problem has emerged - if a computer is attached to lots of projects,
    it may have trouble finishing work in time.
    We are revising the BOINC client's <a href=sched.php>CPU scheduling
    and work-fetch policies</a> to address this issue."
),
array("May 10, 2005",
    "Many BOINC applications have interactive graphics
    (e.g. you can zoom in/out using the mouse).
    For apps that use the latest BOINC API, you can interact
    even when in screensaver mode - just hold down the control key."
),
array("May 10, 2005",
    "We finally have an installer and GUI for Mac OS X!
    It is available as a development version,
    and will become the standard version soon."
),
array("April 11, 2005",
    "Volunteers have ported SETI@home and BOINC to
    <a href=http://boinc.berkeley.edu/download_other.php>a variety of platforms</a>,
    including Solaris/x86-64, Linux/x86-64, Linux/PPC, HP-UX, and FreeBSD."
),

array(
    "March 8, 2005",
    "We released the BOINC Menubar, a user-friendly client software
    version for Macintosh OS X.
    It can be installed and run through a GUI interface -
    no Unix commands.
    We also released the Windows installer announced in
    the January 1 2005 news item.
    Both are available on the <a href=download.php>Download</a> page."
),
array(
    "February 19, 2005",
    "The <a href=http://einstein.phys.uwm.edu/>Einstein@home</a>
    project was officially launched this morning.
    BOINC users are encouraged to participate in this project,
    which searches for spinning neutron stars (also called pulsars)
    using data from the LIGO and GEO gravitational wave detectors.
    "
),
array(
    "February 17, 2005",
    "We've added a <a href=web_translation.php>framework for web-site translations</a>
    (both BOINC-supplied and project-specific parts).
    We are adding support for
    <a href=acct_mgt.php>account management systems</a>
    that simplify participation in multiple projects.
    Security enhancement: all application files are digitally signed.
    "
),
array(
    "January 20, 2005",
    "BOINC source code is now distributed under the
    Lesser GNU Public License (LPGL)."
),
array(
    "January 19, 2005",
    "BOINC-based projects projects now have
    80,721 participants in 188 countries.
    Based on <a href=flops.php>current credit statistics</a>,
    together they supply 106 TeraFLOPS of computing power -
    far more than any conventional supercomputer."
),
array(
    "January 18, 2005",
    "BOINC's message board system supports moderation."
),
array(
    "January 10, 2005",
    "With help from the Einstein@home group, we have refined BOINC's
    <a href=sched_locality.php>locality scheduling</a> mechanism,
    It can now interact with project-specific programs
    that generate work on demand,
    and that maintain a 'working set' of data files
    for which work is distributed."
),
array(
    "January 1, 2005",
    "The Windows version of BOINC can now be configured
    to run when a particular user is logged in,
    to run when any user is logged in,
    or run all the time (as a service)
    even when no users are logged in."
),

array("December 10, 2004",
    "With considerable help from the Einstein@home group,
    we have application graphics working on all platforms, including Linux.
    To handle hosts without graphics libraries,
    we have developed a <a href=graphics.php>new architecture</a> in which
    graphics code resides in a dynamically loaded library."
),
array("December 6, 2004",
    "Added prioritization to work distribution."
),
array("December 3, 2004",
    "We have created a new email list,
    <a href=http://www.ssl.berkeley.edu/mailman/listinfo/boinc_cvs>boinc_cvs@ssl.berkeley.edu</a>.
    A summary of each CVS checkin to the BOINC source tree
    will be posted to this list."
),

array(
    "December 2, 2004",
    "A technical paper about BOINC is
    <a href=grid_paper_04.pdf>here</a>.
    This paper appeared in the
    5th IEEE/ACM International Workshop on Grid Computing,
    November 8, 2004, Pittsburgh, USA."
),
array(
    "November 21, 2004",
    "We have developed a GUI for the core client.
    It's similar to the old Windows GUI but is implemented
    using <a href=http://www.wxwidgets.org/>wxWidgets</a>
    so it runs on all platforms.
    It offers new features such as the ability to
    suspend/resume projects and results,
    and project-specific web links.
    It uses a socket-based GUI RPC mechanism,
    which makes it possible to develop other GUIs,
    including ones that control many hosts.
    "
),
array(
    "November 21, 2004",
    "A new utility, db_purge, allows projects to
    flush old entries from the result and workunit tables,
    so that these tables have a bounded size."
),
array(
    "November 21, 2004",
    "We have developed a new Windows installer
    that lets you run BOINC as a service,
    and that is compatible with the Microsoft MSI framework."
),
array(
    "November 21, 2004",
    "The application graphics framework now works on
    all platforms, including Mac OS X."
),
array(
    "November 21, 2004",
    "The message-board system now supports self-moderation
    (i.e., 'ignore lists')."
),
array(
    "November 21, 2004",
    "BOINC servers can now use read-only database replicas
    for increased throughput."
),
array(
    "September 21, 2004",
    "XML Schemas for the statistics data exported by BOINC projects
    is <a href=BOINCSchemas/>here</a>,
    and graphical representations are
    <a href=BOINCSchemas/documentation/>here</a>."
),
array(
    "September 14, 2004",
    "We have created an email list, boinc_opt@ssl.berkeley.edu,
    for people interested in porting and optimizing BOINC applications.
    Sign up <a href=http://www.ssl.berkeley.edu/mailman/listinfo/boinc_opt>here</a>."
),
array(
    "September 11, 2004",
    "We are working on a new type of work distribution, called
    <a href=sched_locality.php>Locality scheduling</a>,
    that sends work to hosts that already have the needed files."
),
array(
    "September 6, 2004",
    "The <a href=http://lattice.umiacs.umd.edu/>Lattice</a> project
    from the University of Maryland
    is developing a Grid system that integrates Globus,
    BOINC, and several other software components."
),
array(
    "September 1, 2004",
    "The new project LHC@home announces its first beta test,
    initially restricted to 1000 users.
    Please sign up at <a href=http://lhcathome.cern.ch>lhcathome.cern.ch</a>."
),
array(
    "August 26, 2004",
    "The <a href=http://climateprediction.net/>Climateprediction.net</a>
    project is now open to the public."
),
array(
    "August 6, 2004",
    "Users can choose whether applications should
    quit or suspend when they're not executing."
),
array(
    "August 5, 2004",
    "The core client now checks whether disk usage exceeds
    user-specified limits, and if so it deletes projects files
    in a way that respects project resource shares."
),
array(
    "August 5, 2004",
    "Large BOINC projects (like SETI@home) were getting
    on the order of a million files in upload/download directories.
    This caused OS performance problems.
    We fixed this by providing a two-level directory
    hierarchy for upload/download directories."
),
array(
    "August 3, 2004",
    "The Climateprediction.net project recently held an
    <a href=http://www.climateprediction.net/project/openday.php>Open Day</a>,
    describing its status and its plans to use BOINC.
    "
),
array(
    "July 9, 2004",
    "We made the core/app interface more flexible and general,
    providing better support for applications that consist
    of separate controller, worker, and graphics programs.
    We also added mechanisms that prevent
    multiple applications from running in the same slot,
    and that cause applications to exit if the core client dies.
    "
),
array(
    "July 9, 2004",
    "We changed the SQL queries used by the performance-critical
    server components, such as the transitioner and feeder,
    to boost maximum server throughput."
),
array(
    "July 9, 2004",
    "The core client now does preemptive scheduling of results.
    It time-slices between results,
    maintaining the approximate project resource shares.
    The work-fetch policy has also been modified;
    a single 'connection frequency' parameter replaces the
    min/max buffer parameter,
    and the policy matches the requirements of the CPU-scheduling policy."
),
array(
    "July 9, 2004",
    "We have added a mechanism that allows projects to
    upload and download 'persistent files'.
    This is the first step to using participant hosts for storage
    as well as computation, possibly creating
    the world's largest storage server."
),
array(
    "June 20, 2004",
    "The <a href=db_dump.php>statistics export mechanism</a> has been redesigned
    to give projects more control over what they export;
    e.g. they can shift the burden of sorting to statistics web sites."
),
array(
    "June 16, 2004",
    "New features: support for multi-program applications.
    Daily result quota per host.
    Applications can supply a static graphic
    (for screensaver) without writing code.
    Improved support for FORTRAN.
    Support for GUI RPCs in Windows client.
    Option for allowing GUI RPCs from non-local hosts.
    Check for keyboard/mouse input in Unix.
    Support for name/password authentication for HTTP proxies."
),

array("May 31, 2004",
    "BOINC news is available as an RSS feed;
    see Community and Resources."
),

array(
    "May 19, 2004",
    "CPU benchmarking (and credit) are now based on
    the Dhrystone and Whetstone benchmarks.
    Memory bandwidth is no longer measured."
),

array("May 18, 2004",
"Source code is now available
<a href=source_code.php>directly via CVS</a>.
Improved Unix signal handling.
Support app versions, workunits and results with lots of files
(changed XML fields from 4KB to 64KB).
Added
<a href=homogeneous_redundancy.php>homogeneous redundancy</a> mechanism.
"),

array("May 2, 2004",
"General preferences are now propagated from client to server,
but only to accounts with the same email address
as where the preferences originated.
"),

array("April 20, 2004",
"Added <a href=cpid.php>cross-project identification</a> system.
Added support for caching of PHP web pages,
and restored leaderboard pages.
"),

array("April 12, 2004",
"Recent fixes and features:
<a href=http://boinc.berkeley.edu/trickle.php>trickle messages</a>
for long-running work units;
benchmarking for hyperthreaded CPUs;
don't propagate preferences from hosts to projects;
check for file existence before running apps;
SOCKS proxy support;
separate suspend/resume for network activity;
fix race conditions in server;
add file compression code.
See checkin_notes for details.
"),

array("March 16, 2004",
"An unauthorized
<a href=calvin-hobbes-boinc.jpg>BOINC graphic</a>.
"),

array("February 11, 2004",
"BOINC is being used at the Scripps Research Institute
to run a distributed version of CHARMM
(a program for macromolecular simulations).
"),

array("February 1, 2004",
"BOINC now has an
<a href=anonymous_platform.php>anonymous platform mechanism</a>
which 1) allows computers of any type to participate
in a BOINC project, and 2) allows participants to
run only software they have compiled themselves,
should they so desire.

"),

array("January 22, 2004",
"The BOINC core client now provides
<a href=gui_rpc.php>a set of RPCs allowing separate GUIs to be developed</a>.
"),

array("November 26, 2003",
"The CVS repository of BOINC code (including web pages) is now visible through
<a href=http://boinc.berkeley.edu/cgi-bin/cvsweb.cgi/>a web-based interface</a>.
This may be useful for people maintaining web-site translations.
"),

array("November 26, 2003",
"A <a href=http://boinc.berkeley.edu/madrid.html>paper
about the goals of BOINC</a> was presented at a recent conference.
"),

array("November 25, 2003",
"The beta test project is accepting new users.
CPU time measurement accuracy improved.
Scheduler respects disk usage limits.
Web site can issue cookies.
"),

array("November 5, 2003",
"The graphics of running application are updated whenever
preferences are changed.
The scheduler now issues only as many results as will fit in
the allotted amount of disk space.

"),

array("October 30, 2003",
"New minor versions of the core client and beta-test apps have been released.
XML statistics data for the beta test
<a href=http://setiboinc.ssl.berkeley.edu/ap/stats.php>is available</a>;
it's intended for graphical or tabular representation.
"),

array("October 18, 2003",
"A SETI@home application has been added to the beta test.
The scheduling server detect results that can't be sent
to any hosts, and flags them.
HTTP 404 errors on downloads are treated as unrecoverable.
Graphics can be limited by frame rate or percent of CPU.
Don't send two results from the same workunit to a single user.
Added JPEG support to application graphics.
Added \"confirm before accept executable\" mechanism.

"),

array("September 11, 2003",
"BOINC is discussed in
<a href=http://www.nytimes.com/2003/09/11/technology/circuits/11dist.html>
an article by Joan Oleck in the New York TImes</a>.
"),


array("September 4, 2003",
"We've released BOINC version 2.0.
All BOINC components must be upgraded to major version 2.
We've upgraded the <a
href=http://maggie.ssl.Berkeley.edu/ap/>Astropulse</a> server to 2.01 and
released <a href=http://setiboinc.ssl.Berkeley.edu/ap/download.php>BOINC core
client 2.01</a>.
This was due to an architecture and protocol change in
specifying resource estimates and limits.
"),

array("September 1, 2003",
"BOINC server tools are now Python-based.  A <a href=python.php>database
back-end API</a> allows quick development of data-manipulation utilities.
"),

array("August 15, 2003",
"We rewrote parts of the scheduling server architecture to make operations
more flexible and efficient.
The <code>timeout_check</code>
daemon has been replaced by a more general <code>transitioner</code> daemon.
"),

array("July 25, 2003",
"We've added two new web-site features for BOINC projects:
user profiles and message boards.
These are visible on the <a href=http://maggie.ssl.berkeley.edu/ap/>beta-test web site</a>.
"),

array("July 23, 2003",
"The <a href=source/>BOINC source code</a> is available again,
under <a href=legal.html>a new public license</a>.
Version 1.05 incorporates bug fixes and new features,
including the ability to add your own graphics to the screensaver.
The beta test has been resumed, and the scheduling server and
database have been moved to a new machine.
"),

array("June 10, 2003",
"<a href=http://boinc.berkeley.edu/db_dump.php>XML based statistics</a> for
the Astropulse beta test are
<a href=http://setiboinc.ssl.berkeley.edu/ap/stats/>available</a>.
"),

array("May 30, 2003",
"No big news to report,
but thanks to the beta test we've fixed a number of bugs,
involving runaway applications, too-large output files,
screensaver behavior, and mechanisms for
quitting and resetting projects.
"),

array("April 29, 2003",
"We have created a second project, allowing beta testers to
experiment with dividing their resources between multiple projects.
"),

array("April 23, 2003",
"We have resumed the BOINC beta test.
"),

array("April 9, 2003",
"Due to a legal issue,
we are suspending the BOINC beta test,
and we have requested that BOINC source code
no longer be available at Sourceforge.net.
We hope to resolve this issue soon.
"),

array("March 31, 2003",
"We are preparing a BOINC-based version of SETI@home.
See a <a href=setiathome.jpg>preview of the graphics</a>.
"),

array("March 25, 2003",
"<a href=http://www.boinc.dk/index.php?page=download_languages>Non-English
language.ini files</a> are available.
Preferences include time-of-day restrictions.
Core client and applications communicate via shared memory and signals
rather than files, reducing disk traffic.
"),

array("March 19, 2003",
"New account parameters and preferences: URL, limit number of processors,
frequency of writes to disk, whether to show your computers on the web.
"),

array("March 4, 2003",
"Participants can have separate preferences
(such as network and disk usage limits)
for computers at home, work, and school.
"),

array("February 25, 2003",
"Participants can limit their upstream and downstream network bandwidth.
"),

array("February 22, 2003",
"Participants can control the parameters (color, transparency,
timing) of the Astropulse graphics.
"),

array("February 19, 2003",
"New feature: secure, verified email address update.
"),

array("January 29, 2003",
"A <a href=http://setiathome.berkeley.edu/~eheien/ap_ss.jpg>screenshot</a> of the
BOINC client running AstroPulse, our first test application.
"),

array("December 10, 2002",
"We have started a beta test of BOINC using
the Astropulse application.
Many bugs have been found and fixed.
"),

array("August 24, 2002",
"BOINC is under development.
The basic features are working on UNIX platforms.
We plan to release the first public application of BOINC later this year.
")
);

?>
