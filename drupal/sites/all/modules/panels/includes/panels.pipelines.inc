<?php

/**
 * @file
 * Bulk export of panels_layouts objects generated by Bulk export module.
 */

/**
 * Implementation of hook_default_panels_renderer_pipeline().
 */
function panels_default_panels_renderer_pipeline() {
  $pipelines = array();

  $pipeline = new stdClass;
  $pipeline->disabled = FALSE; /* Edit this to true to make a default pipeline disabled initially */
  $pipeline->api_version = 1;
  $pipeline->name = 'standard';
  $pipeline->admin_title = t('Standard');
  $pipeline->admin_description = t('Renders a panel normally. This is the most common option.');
  $pipeline->weight = -100;
  $pipeline->settings = array(
    'renderers' => array(
      0 => array(
        'access' => array(),
        'renderer' => 'standard',
        'options' => array(),
      ),
    ),
  );
  $pipelines[$pipeline->name] = $pipeline;

  return $pipelines;
}
