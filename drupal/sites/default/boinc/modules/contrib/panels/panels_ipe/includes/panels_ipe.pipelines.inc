<?php

/**
 * @file
 * Bulk export of panels_layouts objects generated by Bulk export module.
 */

/**
 * Implementation of hook_default_panels_renderer_pipeline().
 */
function panels_ipe_default_panels_renderer_pipeline() {
  $pipelines = array();

  $pipeline = new stdClass;
  $pipeline->disabled = FALSE; /* Edit this to true to make a default pipeline disabled initially */
  $pipeline->api_version = 1;
  $pipeline->name = 'ipe';
  $pipeline->admin_title = t('In-Place Editor');
  $pipeline->admin_description = t('Allows privileged users to update and rearrange the content while viewing this panel.');
  $pipeline->weight = 0;
  $pipeline->settings = array(
    'renderers' => array(
      0 => array(
        'access' => array(
          'plugins' => array(
            0 => array(
              'name' => 'perm',
              'settings' => array(
                'perm' => 'use panels in place editing',
              ),
              'context' => 'logged-in-user',
            ),
          ),
          'logic' => 'and',
        ),
        'renderer' => 'ipe',
        'options' => array(),
      ),
    ),
  );
  $pipelines[$pipeline->name] = $pipeline;

  return $pipelines;
}
