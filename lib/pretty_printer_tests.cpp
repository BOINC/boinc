#include <string>
#include "../lib/pretty_printer.h"
#include <map>
#include <vector>

using std::string;
using std::map;
using std::pair;
using std::vector;

map<string, pair<int, int>> results;
vector<string> order;

pretty_printer A;
int passed;
int total;

int all_passed = 0;
int all_total = 0;

void test(const string& name, const string& expected, const bool& console = false, const bool& clear = true, pretty_printer& printer = A) {
    total++;
    all_total++;

    if (expected == printer.prettify(console)) {
        passed++;
        all_passed++;
        
        printf("%s test passed\n", name.c_str());
    } else {
        printf("%s test failed\n", name.c_str());
        printf("Expected:\n%s\n\nActual:\n%s\n\n", expected.c_str(), printer.prettify(console).c_str());
    }

    if (clear) {
        printer.clear();
    }
}

void finalize(string name) {
    results.insert(pair<string, pair<int, int>>(name, pair<int, int>(passed, total)));
    order.push_back(name);

    passed = total = 0;
}

int run_tests() {
    string expected;
    
    printf("\nNUMBERS\n");
    passed = total = 0;

    A.insert("Key", 0);
    test("Zero", "{\n   \"Key\": 0\n}");

    A.insert("Key", 1);
    test("Positive", "{\n   \"Key\": 1\n}");

    A.insert("Key", 14155324355633456215);
    test("Huge Positive", "{\n   \"Key\": 14155324355633456215\n}");

    A.insert("Key", 1234123423135321421);
    test("Large Positive", "{\n   \"Key\": 1234123423135321421\n}");

    A.insert("Key", -1234123423135321421);
    test("Large Negative", "{\n   \"Key\": -1234123423135321421\n}");

    A.insert("Key", 0.012321412);
    test("Positive Decimal", "{\n   \"Key\": 0.01\n}");

    A.insert("Key", -0.012321412);
    test("Negative Decimal", "{\n   \"Key\": -0.01\n}");

    A.insert("Key", 0.013242352532352343242321412);
    test("Large Positive Decimal", "{\n   \"Key\": 0.01\n}");

    A.insert("Key", -0.013242352532352343242321412);
    test("Large Negative Decimal", "{\n   \"Key\": -0.01\n}");
    
    finalize("Numbers");
    
    printf("\nSTRINGS\n");

    A.insert("Key", "abc");
    test("Basic String", "{\n   \"Key\": \"abc\"\n}");

    A.insert("Key", "AbvsaAYghsa");
    test("String Case", "{\n   \"Key\": \"AbvsaAYghsa\"\n}");

    A.insert("Key", 'a');
    test("Char", "{\n   \"Key\": \"a\"\n}");

    A.insert("Key", 'A');
    test("Char Capital", "{\n   \"Key\": \"A\"\n}");

    A.insert("Key", "'A'");
    test("Single Quotes", "{\n   \"Key\": \"'A'\"\n}");

    A.insert("Key", "abc\\\"bc A\\\"");
    test("Double Quotes", "{\n   \"Key\": \"abc\\\"bc A\\\"\"\n}");

    A.insert("Key", "abc\\\"bc A\\\"");
    test("Double Quotes Extra", "{\n   \"Key\": \"abc\\\"bc A\\\"\"\n}");
    
    A.insert("Key", "dsffuighuyighsdzuifhuilhsteiryjuhhjklghuiosfhuisezhiulhgdiugtdhslkjhjhuxdghfkjdhdjkxlfhdsffuighuyighsdzuifhuilhsteiryjuhhjklghuiosfhuisezhiulhgdiugtdhslkjhjhuxdghfkjdhdjkxlfhdsffuighuyighsdzuifhuilhsteiryjuhhjklghuiosfhuisezhiulhgdiugtdhslkjhjhuxdghfkjdhdjkxlfhdsffuighuyighsdzuifhuilhsteiryjuhhjklghuiosfhuisezhiulhgdiugtdhslkjhjhuxdghfkjdhdjkxlfhdsffuighuyighsdzuifhuilhsteiryjuhhjklghuiosfhuisezhiulhgdiugtdhslkjhjhuxdghfkjdhdjkxlfhdsffuighuyighsdzuifhuilhsteiryjuhhjklghuiosfhuisezhiulhgdiugtdhslkjhjhuxdghfkjdhdjkxlfhdsffuighuyighsdzuifhuilhsteiryjuhhjklghuiosfhuisezhiulhgdiugtdhslkjhjhuxdghfkjdhdjkxlfhdsffuighuyighsdzuifhuilhsteiryjuhhjklghuiosfhuisezhiulhgdiugtdhslkjhjhuxdghfkjdhdjkxlfhdsffuighuyighsdzuifhuilhsteiryjuhhjklghuiosfhuisezhiulhgdiugtdhslkjhjhuxdghfkjdhdjkxlfhdsffuighuyighsdzuifhuilhsteiryjuhhjklghuiosfhuisezhiulhgdiugtdhslkjhjhuxdghfkjdhdjkxlfhdsffuighuyighsdzuifhuilhsteiryjuhhjklghuiosfhuisezhiulhgdiugtdhslkjhjhuxdghfkjdhdjkxlfhdsffuighuyighsdzuifhuilhsteiryjuhhjklghuiosfhuisezhiulhgdiugtdhslkjhjhuxdghfkjdhdjkxlfhdsffuighuyighsdzuifhuilhsteiryjuhhjklghuiosfhuisezhiulhgdiugtdhslkjhjhuxdghfkjdhdjkxlfhdsffuighuyighsdzuifhuilhsteiryjuhhjklghuiosfhuisezhiulhgdiugtdhslkjhjhuxdghfkjdhdjkxlfhdsffuighuyighsdzuifhuilhsteiryjuhhjklghuiosfhuisezhiulhgdiugtdhslkjhjhuxdghfkjdhdjkxlfhdsffuighuyighsdzuifhuilhsteiryjuhhjklghuiosfhuisezhiulhgdiugtdhslkjhjhuxdghfkjdhdjkxlfhdsffuighuyighsdzuifhuilhsteiryjuhhjklghuiosfhuisezhiulhgdiugtdhslkjhjhuxdghfkjdhdjkxlfhdsffuighuyighsdzuifhuilhsteiryjuhhjklghuiosfhuisezhiulhgdiugtdhslkjhjhuxdghfkjdhdjkxlfhdsffuighuyighsdzuifhuilhsteiryjuhhjklghuiosfhuisezhiulhgdiugtdhslkjhjhuxdghfkjdhdjkxlfhdsffuighuyighsdzuifhuilhsteiryjuhhjklghuiosfhuisezhiulhgdiugtdhslkjhjhuxdghfkjdhdjkxlfhdsffuighuyighsdzuifhuilhsteiryjuhhjklghuiosfhuisezhiulhgdiugtdhslkjhjhuxdghfkjdhdjkxlfhdsffuighuyighsdzuifhuilhsteiryjuhhjklghuiosfhuisezhiulhgdiugtdhslkjhjhuxdghfkjdhdjkxlfhdsffuighuyighsdzuifhuilhsteiryjuhhjklghuiosfhuisezhiulhgdiugtdhslkjhjhuxdghfkjdhdjkxlfhdsffuighuyighsdzuifhuilhsteiryjuhhjklghuiosfhuisezhiulhgdiugtdhslkjhjhuxdghfkjdhdjkxlfhdsffuighuyighsdzuifhuilhsteiryjuhhjklghuiosfhuisezhiulhgdiugtdhslkjhjhuxdghfkjdhdjkxlfhdsffuighuyighsdzuifhuilhsteiryjuhhjklghuiosfhuisezhiulhgdiugtdhslkjhjhuxdghfkjdhdjkxlfhdsffuighuyighsdzuifhuilhsteiryjuhhjklghuiosfhuisezhiulhgdiugtdhslkjhjhuxdghfkjdhdjkxlfhdsffuighuyighsdzuifhuilhsteiryjuhhjklghuiosfhuisezhiulhgdiugtdhslkjhjhuxdghfkjdhdjkxlfhdsffuighuyighsdzuifhuilhsteiryjuhhjklghuiosfhuisezhiulhgdiugtdhslkjhjhuxdghfkjdhdjkxlfhdsffuighuyighsdzuifhuilhsteiryjuhhjklghuiosfhuisezhiulhgdiugtdhslkjhjhuxdghfkjdhdjkxlfhdsffuighuyighsdzuifhuilhsteiryjuhhjklghuiosfhuisezhiulhgdiugtdhslkjhjhuxdghfkjdhdjkxlfhdsffuighuyighsdzuifhuilhsteiryjuhhjklghuiosfhuisezhiulhgdiugtdhslkjhjhuxdghfkjdhdjkxlfhdsffuighuyighsdzuifhuilhsteiryjuhhjklghuiosfhuisezhiulhgdiugtdhslkjhjhuxdghfkjdhdjkxlfhdsffuighuyighsdzuifhuilhsteiryjuhhjklghuiosfhuisezhiulhgdiugtdhslkjhjhuxdghfkjdhdjkxlfhdsffuighuyighsdzuifhuilhsteiryjuhhjklghuiosfhuisezhiulhgdiugtdhslkjhjhuxdghfkjdhdjkxlfhdsffuighuyighsdzuifhuilhsteiryjuhhjklghuiosfhuisezhiulhgdiugtdhslkjhjhuxdghfkjdhdjkxlfhdsffuighuyighsdzuifhuilhsteiryjuhhjklghuiosfhuisezhiulhgdiugtdhslkjhjhuxdghfkjdhdjkxlfhdsffuighuyighsdzuifhuilhsteiryjuhhjklghuiosfhuisezhiulhgdiugtdhslkjhjhuxdghfkjdhdjkxlfhdsffuighuyighsdzuifhuilhsteiryjuhhjklghuiosfhuisezhiulhgdiugtdhslkjhjhuxdghfkjdhdjkxlfhdsffuighuyighsdzuifhuilhsteiryjuhhjklghuiosfhuisezhiulhgdiugtdhslkjhjhuxdghfkjdhdjkxlfhdsffuighuyighsdzuifhuilhsteiryjuhhjklghuiosfhuisezhiulhgdiugtdhslkjhjhuxdghfkjdhdjkxlfhdsffuighuyighsdzuifhuilhsteiryjuhhjklghuiosfhuisezhiulhgdiugtdhslkjhjhuxdghfkjdhdjkxlfhdsffuighuyighsdzuifhuilhsteiryjuhhjklghuiosfhuisezhiulhgdiugtdhslkjhjhuxdghfkjdhdjkxlfhdsffuighuyighsdzuifhuilhsteiryjuhhjklghuiosfhuisezhiulhgdiugtdhslkjhjhuxdghfkjdhdjkxlfhdsffuighuyighsdzuifhuilhsteiryjuhhjklghuiosfhuisezhiulhgdiugtdhslkjhjhuxdghfkjdhdjkxlfhdsffuighuyighsdzuifhuilhsteiryjuhhjklghuiosfhuisezhiulhgdiugtdhslkjhjhuxdghfkjdhdjkxlfhdsffuighuyighsdzuifhuilhsteiryjuhhjklghuiosfhuisezhiulhgdiugtdhslkjhjhuxdghfkjdhdjkxlfhdsffuighuyighsdzuifhuilhsteiryjuhhjklghuiosfhuisezhiulhgdiugtdhslkjhjhuxdghfkjdhdjkxlfhdsffuighuyighsdzuifhuilhsteiryjuhhjklghuiosfhuisezhiulhgdiugtdhslkjhjhuxdghfkjdhdjkxlfhdsffuighuyighsdzuifhuilhsteiryjuhhjklghuiosfhuisezhiulhgdiugtdhslkjhjhuxdghfkjdhdjkxlfhdsffuighuyighsdzuifhuilhsteiryjuhhjklghuiosfhuisezhiulhgdiugtdhslkjhjhuxdghfkjdhdjkxlfhdsffuighuyighsdzuifhuilhsteiryjuhhjklghuiosfhuisezhiulhgdiugtdhslkjhjhuxdghfkjdhdjkxlfhdsffuighuyighsdzuifhuilhsteiryjuhhjklghuiosfhuisezhiulhgdiugtdhslkjhjhuxdghfkjdhdjkxlfhdsffuighuyighsdzuifhuilhsteiryjuhhjklghuiosfhuisezhiulhgdiugtdhslkjhjhuxdghfkjdhdjkxlfhdsffuighuyighsdzuifhuilhsteiryjuhhjklghuiosfhuisezhiulhgdiugtdhslkjhjhuxdghfkjdhdjkxlfhdsffuighuyighsdzuifhuilhsteiryjuhhjklghuiosfhuisezhiulhgdiugtdhslkjhjhuxdghfkjdhdjkxlfhdsffuighuyighsdzuifhuilhsteiryjuhhjklghuiosfhuisezhiulhgdiugtdhslkjhjhuxdghfkjdhdjkxlfhdsffuighuyighsdzuifhuilhsteiryjuhhjklghuiosfhuisezhiulhgdiugtdhslkjhjhuxdghfkjdhdjkxlfhdsffuighuyighsdzuifhuilhsteiryjuhhjklghuiosfhuisezhiulhgdiugtdhslkjhjhuxdghfkjdhdjkxlfhdsffuighuyighsdzuifhuilhsteiryjuhhjklghuiosfhuisezhiulhgdiugtdhslkjhjhuxdghfkjdhdjkxlfhdsffuighuyighsdzuifhuilhsteiryjuhhjklghuiosfhuisezhiulhgdiugtdhslkjhjhuxdghfkjdhdjkxlfhdsffuighuyighsdzuifhuilhsteiryjuhhjklghuiosfhuisezhiulhgdiugtdhslkjhjhuxdghfkjdhdjkxlfhdsffuighuyighsdzuifhuilhsteiryjuhhjklghuiosfhuisezhiulhgdiugtdhslkjhjhuxdghfkjdhdjkxlfhdsffuighuyighsdzuifhuilhsteiryjuhhjklghuiosfhuisezhiulhgdiugtdhslkjhjhuxdghfkjdhdjkxlfhdsffuighuyighsdzuifhuilhsteiryjuhhjklghuiosfhuisezhiulhgdiugtdhslkjhjhuxdghfkjdhdjkxlfhdsffuighuyighsdzuifhuilhsteiryjuhhjklghuiosfhuisezhiulhgdiugtdhslkjhjhuxdghfkjdhdjkxlfhdsffuighuyighsdzuifhuilhsteiryjuhhjklghuiosfhuisezhiulhgdiugtdhslkjhjhuxdghfkjdhdjkxlfhdsffuighuyighsdzuifhuilhsteiryjuhhjklghuiosfhuisezhiulhgdiugtdhslkjhjhuxdghfkjdhdjkxlfhdsffuighuyighsdzuifhuilhsteiryjuhhjklghuiosfhuisezhiulhgdiugtdhslkjhjhuxdghfkjdhdjkxlfhdsffuighuyighsdzuifhuilhsteiryjuhhjklghuiosfhuisezhiulhgdiugtdhslkjhjhuxdghfkjdhdjkxlfhdsffuighuyighsdzuifhuilhsteiryjuhhjklghuiosfhuisezhiulhgdiugtdhslkjhjhuxdghfkjdhdjkxlfhdsffuighuyighsdzuifhuilhsteiryjuhhjklghuiosfhuisezhiulhgdiugtdhslkjhjhuxdghfkjdhdjkxlfhdsffuighuyighsdzuifhuilhsteiryjuhhjklghuiosfhuisezhiulhgdiugtdhslkjhjhuxdghfkjdhdjkxlfhdsffuighuyighsdzuifhuilhsteiryjuhhjklghuiosfhuisezhiulhgdiugtdhslkjhjhuxdghfkjdhdjkxlfhdsffuighuyighsdzuifhuilhsteiryjuhhjklghuiosfhuisezhiulhgdiugtdhslkjhjhuxdghfkjdhdjkxlfhdsffuighuyighsdzuifhuilhsteiryjuhhjklghuiosfhuisezhiulhgdiugtdhslkjhjhuxdghfkjdhdjkxlfhdsffuighuyighsdzuifhuilhsteiryjuhhjklghuiosfhuisezhiulhgdiugtdhslkjhjhuxdghfkjdhdjkxlfhdsffuighuyighsdzuifhuilhsteiryjuhhjklghuiosfhuisezhiulhgdiugtdhslkjhjhuxdghfkjdhdjkxlfhdsffuighuyighsdzuifhuilhsteiryjuhhjklghuiosfhuisezhiulhgdiugtdhslkjhjhuxdghfkjdhdjkxlfhdsffuighuyighsdzuifhuilhsteiryjuhhjklghuiosfhuisezhiulhgdiugtdhslkjhjhuxdghfkjdhdjkxlfhdsffuighuyighsdzuifhuilhsteiryjuhhjklghuiosfhuisezhiulhgdiugtdhslkjhjhuxdghfkjdhdjkxlfhdsffuighuyighsdzuifhuilhsteiryjuhhjklghuiosfhuisezhiulhgdiugtdhslkjhjhuxdghfkjdhdjkxlfhdsffuighuyighsdzuifhuilhsteiryjuhhjklghuiosfhuisezhiulhgdiugtdhslkjhjhuxdghfkjdhdjkxlfhdsffuighuyighsdzuifhuilhsteiryjuhhjklghuiosfhuisezhiulhgdiugtdhslkjhjhuxdghfkjdhdjkxlfhdsffuighuyighsdzuifhuilhsteiryjuhhjklghuiosfhuisezhiulhgdiugtdhslkjhjhuxdghfkjdhdjkxlfhdsffuighuyighsdzuifhuilhsteiryjuhhjklghuiosfhuisezhiulhgdiugtdhslkjhjhuxdghfkjdhdjkxlfhdsffuighuyighsdzuifhuilhsteiryjuhhjklghuiosfhuisezhiulhgdiugtdhslkjhjhuxdghfkjdhdjkxlfhdsffuighuyighsdzuifhuilhsteiryjuhhjklghuiosfhuisezhiulhgdiugtdhslkjhjhuxdghfkjdhdjkxlfhdsffuighuyighsdzuifhuilhsteiryjuhhjklghuiosfhuisezhiulhgdiugtdhslkjhjhuxdghfkjdhdjkxlfhdsffuighuyighsdzuifhuilhsteiryjuhhjklghuiosfhuisezhiulhgdiugtdhslkjhjhuxdghfkjdhdjkxlfhdsffuighuyighsdzuifhuilhsteiryjuhhjklghuiosfhuisezhiulhgdiugtdhslkjhjhuxdghfkjdhdjkxlfhdsffuighuyighsdzuifhuilhsteiryjuhhjklghuiosfhuisezhiulhgdiugtdhslkjhjhuxdghfkjdhdjkxlfhdsffuighuyighsdzuifhuilhsteiryjuhhjklghuiosfhuisezhiulhgdiugtdhslkjhjhuxdghfkjdhdjkxlfhdsffuighuyighsdzuifhuilhsteiryjuhhjklghuiosfhuisezhiulhgdiugtdhslkjhjhuxdghfkjdhdjkxlfhdsffuighuyighsdzuifhuilhsteiryjuhhjklghuiosfhuisezhiulhgdiugtdhslkjhjhuxdghfkjdhdjkxlfhdsffuighuyighsdzuifhuilhsteiryjuhhjklghuiosfhuisezhiulhgdiugtdhslkjhjhuxdghfkjdhdjkxlfhdsffuighuyighsdzuifhuilhsteiryjuhhjklghuiosfhuisezhiulhgdiugtdhslkjhjhuxdghfkjdhdjkxlfhdsffuighuyighsdzuifhuilhsteiryjuhhjklghuiosfhuisezhiulhgdiugtdhslkjhjhuxdghfkjdhdjkxlfhdsffuighuyighsdzuifhuilhsteiryjuhhjklghuiosfhuisezhiulhgdiugtdhslkjhjhuxdghfkjdhdjkxlfhdsffuighuyighsdzuifhuilhsteiryjuhhjklghuiosfhuisezhiulhgdiugtdhslkjhjhuxdghfkjdhdjkxlfhdsffuighuyighsdzuifhuilhsteiryjuhhjklghuiosfhuisezhiulhgdiugtdhslkjhjhuxdghfkjdhdjkxlfhdsffuighuyighsdzuifhuilhsteiryjuhhjklghuiosfhuisezhiulhgdiugtdhslkjhjhuxdghfkjdhdjkxlfhdsffuighuyighsdzuifhuilhsteiryjuhhjklghuiosfhuisezhiulhgdiugtdhslkjhjhuxdghfkjdhdjkxlfhdsffuighuyighsdzuifhuilhsteiryjuhhjklghuiosfhuisezhiulhgdiugtdhslkjhjhuxdghfkjdhdjkxlfhdsffuighuyighsdzuifhuilhsteiryjuhhjklghuiosfhuisezhiulhgdiugtdhslkjhjhuxdghfkjdhdjkxlfhdsffuighuyighsdzuifhuilhsteiryjuhhjklghuiosfhuisezhiulhgdiugtdhslkjhjhuxdghfkjdhdjkxlfhdsffuighuyighsdzuifhuilhsteiryjuhhjklghuiosfhuisezhiulhgdiugtdhslkjhjhuxdghfkjdhdjkxlfhdsffuighuyighsdzuifhuilhsteiryjuhhjklghuiosfhuisezhiulhgdiugtdhslkjhjhuxdghfkjdhdjkxlfhdsffuighuyighsdzuifhuilhsteiryjuhhjklghuiosfhuisezhiulhgdiugtdhslkjhjhuxdghfkjdhdjkxlfhdsffuighuyighsdzuifhuilhsteiryjuhhjklghuiosfhuisezhiulhgdiugtdhslkjhjhuxdghfkjdhdjkxlfhdsffuighuyighsdzuifhuilhsteiryjuhhjklghuiosfhuisezhiulhgdiugtdhslkjhjhuxdghfkjdhdjkxlfhdsffuighuyighsdzuifhuilhsteiryjuhhjklghuiosfhuisezhiulhgdiugtdhslkjhjhuxdghfkjdhdjkxlfhdsffuighuyighsdzuifhuilhsteiryjuhhjklghuiosfhuisezhiulhgdiugtdhslkjhjhuxdghfkjdhdjkxlfhdsffuighuyighsdzuifhuilhsteiryjuhhjklghuiosfhuisezhiulhgdiugtdhslkjhjhuxdghfkjdhdjkxlfhdsffuighuyighsdzuifhuilhsteiryjuhhjklghuiosfhuisezhiulhgdiugtdhslkjhjhuxdghfkjdhdjkxlfhdsffuighuyighsdzuifhuilhsteiryjuhhjklghuiosfhuisezhiulhgdiugtdhslkjhjhuxdghfkjdhdjkxlfhdsffuighuyighsdzuifhuilhsteiryjuhhjklghuiosfhuisezhiulhgdiugtdhslkjhjhuxdghfkjdhdjkxlfhdsffuighuyighsdzuifhuilhsteiryjuhhjklghuiosfhuisezhiulhgdiugtdhslkjhjhuxdghfkjdhdjkxlfhdsffuighuyighsdzuifhuilhsteiryjuhhjklghuiosfhuisezhiulhgdiugtdhslkjhjhuxdghfkjdhdjkxlfhdsffuighuyighsdzuifhuilhsteiryjuhhjklghuiosfhuisezhiulhgdiugtdhslkjhjhuxdghfkjdhdjkxlfh");
    test("Very Long String", "{\n   \"Key\": \"dsffuighuyighsdzuifhuilhsteiryjuhhjklghuiosfhuisezhiulhgdiugtdhslkjhjhuxdghfkjdhdjkxlfhdsffuighuyighsdzuifhuilhsteiryjuhhjklghuiosfhuisezhiulhgdiugtdhslkjhjhuxdghfkjdhdjkxlfhdsffuighuyighsdzuifhuilhsteiryjuhhjklghuiosfhuisezhiulhgdiugtdhslkjhjhuxdghfkjdhdjkxlfhdsffuighuyighsdzuifhuilhsteiryjuhhjklghuiosfhuisezhiulhgdiugtdhslkjhjhuxdghfkjdhdjkxlfhdsffuighuyighsdzuifhuilhsteiryjuhhjklghuiosfhuisezhiulhgdiugtdhslkjhjhuxdghfkjdhdjkxlfhdsffuighuyighsdzuifhuilhsteiryjuhhjklghuiosfhuisezhiulhgdiugtdhslkjhjhuxdghfkjdhdjkxlfhdsffuighuyighsdzuifhuilhsteiryjuhhjklghuiosfhuisezhiulhgdiugtdhslkjhjhuxdghfkjdhdjkxlfhdsffuighuyighsdzuifhuilhsteiryjuhhjklghuiosfhuisezhiulhgdiugtdhslkjhjhuxdghfkjdhdjkxlfhdsffuighuyighsdzuifhuilhsteiryjuhhjklghuiosfhuisezhiulhgdiugtdhslkjhjhuxdghfkjdhdjkxlfhdsffuighuyighsdzuifhuilhsteiryjuhhjklghuiosfhuisezhiulhgdiugtdhslkjhjhuxdghfkjdhdjkxlfhdsffuighuyighsdzuifhuilhsteiryjuhhjklghuiosfhuisezhiulhgdiugtdhslkjhjhuxdghfkjdhdjkxlfhdsffuighuyighsdzuifhuilhsteiryjuhhjklghuiosfhuisezhiulhgdiugtdhslkjhjhuxdghfkjdhdjkxlfhdsffuighuyighsdzuifhuilhsteiryjuhhjklghuiosfhuisezhiulhgdiugtdhslkjhjhuxdghfkjdhdjkxlfhdsffuighuyighsdzuifhuilhsteiryjuhhjklghuiosfhuisezhiulhgdiugtdhslkjhjhuxdghfkjdhdjkxlfhdsffuighuyighsdzuifhuilhsteiryjuhhjklghuiosfhuisezhiulhgdiugtdhslkjhjhuxdghfkjdhdjkxlfhdsffuighuyighsdzuifhuilhsteiryjuhhjklghuiosfhuisezhiulhgdiugtdhslkjhjhuxdghfkjdhdjkxlfhdsffuighuyighsdzuifhuilhsteiryjuhhjklghuiosfhuisezhiulhgdiugtdhslkjhjhuxdghfkjdhdjkxlfhdsffuighuyighsdzuifhuilhsteiryjuhhjklghuiosfhuisezhiulhgdiugtdhslkjhjhuxdghfkjdhdjkxlfhdsffuighuyighsdzuifhuilhsteiryjuhhjklghuiosfhuisezhiulhgdiugtdhslkjhjhuxdghfkjdhdjkxlfhdsffuighuyighsdzuifhuilhsteiryjuhhjklghuiosfhuisezhiulhgdiugtdhslkjhjhuxdghfkjdhdjkxlfhdsffuighuyighsdzuifhuilhsteiryjuhhjklghuiosfhuisezhiulhgdiugtdhslkjhjhuxdghfkjdhdjkxlfhdsffuighuyighsdzuifhuilhsteiryjuhhjklghuiosfhuisezhiulhgdiugtdhslkjhjhuxdghfkjdhdjkxlfhdsffuighuyighsdzuifhuilhsteiryjuhhjklghuiosfhuisezhiulhgdiugtdhslkjhjhuxdghfkjdhdjkxlfhdsffuighuyighsdzuifhuilhsteiryjuhhjklghuiosfhuisezhiulhgdiugtdhslkjhjhuxdghfkjdhdjkxlfhdsffuighuyighsdzuifhuilhsteiryjuhhjklghuiosfhuisezhiulhgdiugtdhslkjhjhuxdghfkjdhdjkxlfhdsffuighuyighsdzuifhuilhsteiryjuhhjklghuiosfhuisezhiulhgdiugtdhslkjhjhuxdghfkjdhdjkxlfhdsffuighuyighsdzuifhuilhsteiryjuhhjklghuiosfhuisezhiulhgdiugtdhslkjhjhuxdghfkjdhdjkxlfhdsffuighuyighsdzuifhuilhsteiryjuhhjklghuiosfhuisezhiulhgdiugtdhslkjhjhuxdghfkjdhdjkxlfhdsffuighuyighsdzuifhuilhsteiryjuhhjklghuiosfhuisezhiulhgdiugtdhslkjhjhuxdghfkjdhdjkxlfhdsffuighuyighsdzuifhuilhsteiryjuhhjklghuiosfhuisezhiulhgdiugtdhslkjhjhuxdghfkjdhdjkxlfhdsffuighuyighsdzuifhuilhsteiryjuhhjklghuiosfhuisezhiulhgdiugtdhslkjhjhuxdghfkjdhdjkxlfhdsffuighuyighsdzuifhuilhsteiryjuhhjklghuiosfhuisezhiulhgdiugtdhslkjhjhuxdghfkjdhdjkxlfhdsffuighuyighsdzuifhuilhsteiryjuhhjklghuiosfhuisezhiulhgdiugtdhslkjhjhuxdghfkjdhdjkxlfhdsffuighuyighsdzuifhuilhsteiryjuhhjklghuiosfhuisezhiulhgdiugtdhslkjhjhuxdghfkjdhdjkxlfhdsffuighuyighsdzuifhuilhsteiryjuhhjklghuiosfhuisezhiulhgdiugtdhslkjhjhuxdghfkjdhdjkxlfhdsffuighuyighsdzuifhuilhsteiryjuhhjklghuiosfhuisezhiulhgdiugtdhslkjhjhuxdghfkjdhdjkxlfhdsffuighuyighsdzuifhuilhsteiryjuhhjklghuiosfhuisezhiulhgdiugtdhslkjhjhuxdghfkjdhdjkxlfhdsffuighuyighsdzuifhuilhsteiryjuhhjklghuiosfhuisezhiulhgdiugtdhslkjhjhuxdghfkjdhdjkxlfhdsffuighuyighsdzuifhuilhsteiryjuhhjklghuiosfhuisezhiulhgdiugtdhslkjhjhuxdghfkjdhdjkxlfhdsffuighuyighsdzuifhuilhsteiryjuhhjklghuiosfhuisezhiulhgdiugtdhslkjhjhuxdghfkjdhdjkxlfhdsffuighuyighsdzuifhuilhsteiryjuhhjklghuiosfhuisezhiulhgdiugtdhslkjhjhuxdghfkjdhdjkxlfhdsffuighuyighsdzuifhuilhsteiryjuhhjklghuiosfhuisezhiulhgdiugtdhslkjhjhuxdghfkjdhdjkxlfhdsffuighuyighsdzuifhuilhsteiryjuhhjklghuiosfhuisezhiulhgdiugtdhslkjhjhuxdghfkjdhdjkxlfhdsffuighuyighsdzuifhuilhsteiryjuhhjklghuiosfhuisezhiulhgdiugtdhslkjhjhuxdghfkjdhdjkxlfhdsffuighuyighsdzuifhuilhsteiryjuhhjklghuiosfhuisezhiulhgdiugtdhslkjhjhuxdghfkjdhdjkxlfhdsffuighuyighsdzuifhuilhsteiryjuhhjklghuiosfhuisezhiulhgdiugtdhslkjhjhuxdghfkjdhdjkxlfhdsffuighuyighsdzuifhuilhsteiryjuhhjklghuiosfhuisezhiulhgdiugtdhslkjhjhuxdghfkjdhdjkxlfhdsffuighuyighsdzuifhuilhsteiryjuhhjklghuiosfhuisezhiulhgdiugtdhslkjhjhuxdghfkjdhdjkxlfhdsffuighuyighsdzuifhuilhsteiryjuhhjklghuiosfhuisezhiulhgdiugtdhslkjhjhuxdghfkjdhdjkxlfhdsffuighuyighsdzuifhuilhsteiryjuhhjklghuiosfhuisezhiulhgdiugtdhslkjhjhuxdghfkjdhdjkxlfhdsffuighuyighsdzuifhuilhsteiryjuhhjklghuiosfhuisezhiulhgdiugtdhslkjhjhuxdghfkjdhdjkxlfhdsffuighuyighsdzuifhuilhsteiryjuhhjklghuiosfhuisezhiulhgdiugtdhslkjhjhuxdghfkjdhdjkxlfhdsffuighuyighsdzuifhuilhsteiryjuhhjklghuiosfhuisezhiulhgdiugtdhslkjhjhuxdghfkjdhdjkxlfhdsffuighuyighsdzuifhuilhsteiryjuhhjklghuiosfhuisezhiulhgdiugtdhslkjhjhuxdghfkjdhdjkxlfhdsffuighuyighsdzuifhuilhsteiryjuhhjklghuiosfhuisezhiulhgdiugtdhslkjhjhuxdghfkjdhdjkxlfhdsffuighuyighsdzuifhuilhsteiryjuhhjklghuiosfhuisezhiulhgdiugtdhslkjhjhuxdghfkjdhdjkxlfhdsffuighuyighsdzuifhuilhsteiryjuhhjklghuiosfhuisezhiulhgdiugtdhslkjhjhuxdghfkjdhdjkxlfhdsffuighuyighsdzuifhuilhsteiryjuhhjklghuiosfhuisezhiulhgdiugtdhslkjhjhuxdghfkjdhdjkxlfhdsffuighuyighsdzuifhuilhsteiryjuhhjklghuiosfhuisezhiulhgdiugtdhslkjhjhuxdghfkjdhdjkxlfhdsffuighuyighsdzuifhuilhsteiryjuhhjklghuiosfhuisezhiulhgdiugtdhslkjhjhuxdghfkjdhdjkxlfhdsffuighuyighsdzuifhuilhsteiryjuhhjklghuiosfhuisezhiulhgdiugtdhslkjhjhuxdghfkjdhdjkxlfhdsffuighuyighsdzuifhuilhsteiryjuhhjklghuiosfhuisezhiulhgdiugtdhslkjhjhuxdghfkjdhdjkxlfhdsffuighuyighsdzuifhuilhsteiryjuhhjklghuiosfhuisezhiulhgdiugtdhslkjhjhuxdghfkjdhdjkxlfhdsffuighuyighsdzuifhuilhsteiryjuhhjklghuiosfhuisezhiulhgdiugtdhslkjhjhuxdghfkjdhdjkxlfhdsffuighuyighsdzuifhuilhsteiryjuhhjklghuiosfhuisezhiulhgdiugtdhslkjhjhuxdghfkjdhdjkxlfhdsffuighuyighsdzuifhuilhsteiryjuhhjklghuiosfhuisezhiulhgdiugtdhslkjhjhuxdghfkjdhdjkxlfhdsffuighuyighsdzuifhuilhsteiryjuhhjklghuiosfhuisezhiulhgdiugtdhslkjhjhuxdghfkjdhdjkxlfhdsffuighuyighsdzuifhuilhsteiryjuhhjklghuiosfhuisezhiulhgdiugtdhslkjhjhuxdghfkjdhdjkxlfhdsffuighuyighsdzuifhuilhsteiryjuhhjklghuiosfhuisezhiulhgdiugtdhslkjhjhuxdghfkjdhdjkxlfhdsffuighuyighsdzuifhuilhsteiryjuhhjklghuiosfhuisezhiulhgdiugtdhslkjhjhuxdghfkjdhdjkxlfhdsffuighuyighsdzuifhuilhsteiryjuhhjklghuiosfhuisezhiulhgdiugtdhslkjhjhuxdghfkjdhdjkxlfhdsffuighuyighsdzuifhuilhsteiryjuhhjklghuiosfhuisezhiulhgdiugtdhslkjhjhuxdghfkjdhdjkxlfhdsffuighuyighsdzuifhuilhsteiryjuhhjklghuiosfhuisezhiulhgdiugtdhslkjhjhuxdghfkjdhdjkxlfhdsffuighuyighsdzuifhuilhsteiryjuhhjklghuiosfhuisezhiulhgdiugtdhslkjhjhuxdghfkjdhdjkxlfhdsffuighuyighsdzuifhuilhsteiryjuhhjklghuiosfhuisezhiulhgdiugtdhslkjhjhuxdghfkjdhdjkxlfhdsffuighuyighsdzuifhuilhsteiryjuhhjklghuiosfhuisezhiulhgdiugtdhslkjhjhuxdghfkjdhdjkxlfhdsffuighuyighsdzuifhuilhsteiryjuhhjklghuiosfhuisezhiulhgdiugtdhslkjhjhuxdghfkjdhdjkxlfhdsffuighuyighsdzuifhuilhsteiryjuhhjklghuiosfhuisezhiulhgdiugtdhslkjhjhuxdghfkjdhdjkxlfhdsffuighuyighsdzuifhuilhsteiryjuhhjklghuiosfhuisezhiulhgdiugtdhslkjhjhuxdghfkjdhdjkxlfhdsffuighuyighsdzuifhuilhsteiryjuhhjklghuiosfhuisezhiulhgdiugtdhslkjhjhuxdghfkjdhdjkxlfhdsffuighuyighsdzuifhuilhsteiryjuhhjklghuiosfhuisezhiulhgdiugtdhslkjhjhuxdghfkjdhdjkxlfhdsffuighuyighsdzuifhuilhsteiryjuhhjklghuiosfhuisezhiulhgdiugtdhslkjhjhuxdghfkjdhdjkxlfhdsffuighuyighsdzuifhuilhsteiryjuhhjklghuiosfhuisezhiulhgdiugtdhslkjhjhuxdghfkjdhdjkxlfhdsffuighuyighsdzuifhuilhsteiryjuhhjklghuiosfhuisezhiulhgdiugtdhslkjhjhuxdghfkjdhdjkxlfhdsffuighuyighsdzuifhuilhsteiryjuhhjklghuiosfhuisezhiulhgdiugtdhslkjhjhuxdghfkjdhdjkxlfhdsffuighuyighsdzuifhuilhsteiryjuhhjklghuiosfhuisezhiulhgdiugtdhslkjhjhuxdghfkjdhdjkxlfhdsffuighuyighsdzuifhuilhsteiryjuhhjklghuiosfhuisezhiulhgdiugtdhslkjhjhuxdghfkjdhdjkxlfhdsffuighuyighsdzuifhuilhsteiryjuhhjklghuiosfhuisezhiulhgdiugtdhslkjhjhuxdghfkjdhdjkxlfhdsffuighuyighsdzuifhuilhsteiryjuhhjklghuiosfhuisezhiulhgdiugtdhslkjhjhuxdghfkjdhdjkxlfhdsffuighuyighsdzuifhuilhsteiryjuhhjklghuiosfhuisezhiulhgdiugtdhslkjhjhuxdghfkjdhdjkxlfhdsffuighuyighsdzuifhuilhsteiryjuhhjklghuiosfhuisezhiulhgdiugtdhslkjhjhuxdghfkjdhdjkxlfhdsffuighuyighsdzuifhuilhsteiryjuhhjklghuiosfhuisezhiulhgdiugtdhslkjhjhuxdghfkjdhdjkxlfhdsffuighuyighsdzuifhuilhsteiryjuhhjklghuiosfhuisezhiulhgdiugtdhslkjhjhuxdghfkjdhdjkxlfhdsffuighuyighsdzuifhuilhsteiryjuhhjklghuiosfhuisezhiulhgdiugtdhslkjhjhuxdghfkjdhdjkxlfhdsffuighuyighsdzuifhuilhsteiryjuhhjklghuiosfhuisezhiulhgdiugtdhslkjhjhuxdghfkjdhdjkxlfhdsffuighuyighsdzuifhuilhsteiryjuhhjklghuiosfhuisezhiulhgdiugtdhslkjhjhuxdghfkjdhdjkxlfhdsffuighuyighsdzuifhuilhsteiryjuhhjklghuiosfhuisezhiulhgdiugtdhslkjhjhuxdghfkjdhdjkxlfhdsffuighuyighsdzuifhuilhsteiryjuhhjklghuiosfhuisezhiulhgdiugtdhslkjhjhuxdghfkjdhdjkxlfhdsffuighuyighsdzuifhuilhsteiryjuhhjklghuiosfhuisezhiulhgdiugtdhslkjhjhuxdghfkjdhdjkxlfhdsffuighuyighsdzuifhuilhsteiryjuhhjklghuiosfhuisezhiulhgdiugtdhslkjhjhuxdghfkjdhdjkxlfhdsffuighuyighsdzuifhuilhsteiryjuhhjklghuiosfhuisezhiulhgdiugtdhslkjhjhuxdghfkjdhdjkxlfhdsffuighuyighsdzuifhuilhsteiryjuhhjklghuiosfhuisezhiulhgdiugtdhslkjhjhuxdghfkjdhdjkxlfhdsffuighuyighsdzuifhuilhsteiryjuhhjklghuiosfhuisezhiulhgdiugtdhslkjhjhuxdghfkjdhdjkxlfhdsffuighuyighsdzuifhuilhsteiryjuhhjklghuiosfhuisezhiulhgdiugtdhslkjhjhuxdghfkjdhdjkxlfhdsffuighuyighsdzuifhuilhsteiryjuhhjklghuiosfhuisezhiulhgdiugtdhslkjhjhuxdghfkjdhdjkxlfhdsffuighuyighsdzuifhuilhsteiryjuhhjklghuiosfhuisezhiulhgdiugtdhslkjhjhuxdghfkjdhdjkxlfhdsffuighuyighsdzuifhuilhsteiryjuhhjklghuiosfhuisezhiulhgdiugtdhslkjhjhuxdghfkjdhdjkxlfhdsffuighuyighsdzuifhuilhsteiryjuhhjklghuiosfhuisezhiulhgdiugtdhslkjhjhuxdghfkjdhdjkxlfhdsffuighuyighsdzuifhuilhsteiryjuhhjklghuiosfhuisezhiulhgdiugtdhslkjhjhuxdghfkjdhdjkxlfhdsffuighuyighsdzuifhuilhsteiryjuhhjklghuiosfhuisezhiulhgdiugtdhslkjhjhuxdghfkjdhdjkxlfhdsffuighuyighsdzuifhuilhsteiryjuhhjklghuiosfhuisezhiulhgdiugtdhslkjhjhuxdghfkjdhdjkxlfhdsffuighuyighsdzuifhuilhsteiryjuhhjklghuiosfhuisezhiulhgdiugtdhslkjhjhuxdghfkjdhdjkxlfhdsffuighuyighsdzuifhuilhsteiryjuhhjklghuiosfhuisezhiulhgdiugtdhslkjhjhuxdghfkjdhdjkxlfhdsffuighuyighsdzuifhuilhsteiryjuhhjklghuiosfhuisezhiulhgdiugtdhslkjhjhuxdghfkjdhdjkxlfhdsffuighuyighsdzuifhuilhsteiryjuhhjklghuiosfhuisezhiulhgdiugtdhslkjhjhuxdghfkjdhdjkxlfhdsffuighuyighsdzuifhuilhsteiryjuhhjklghuiosfhuisezhiulhgdiugtdhslkjhjhuxdghfkjdhdjkxlfhdsffuighuyighsdzuifhuilhsteiryjuhhjklghuiosfhuisezhiulhgdiugtdhslkjhjhuxdghfkjdhdjkxlfhdsffuighuyighsdzuifhuilhsteiryjuhhjklghuiosfhuisezhiulhgdiugtdhslkjhjhuxdghfkjdhdjkxlfhdsffuighuyighsdzuifhuilhsteiryjuhhjklghuiosfhuisezhiulhgdiugtdhslkjhjhuxdghfkjdhdjkxlfhdsffuighuyighsdzuifhuilhsteiryjuhhjklghuiosfhuisezhiulhgdiugtdhslkjhjhuxdghfkjdhdjkxlfh\"\n}");

    A.insert("Key", "?.,,./<>!@#$%^&*()_+-=");
    test("Special Characters", "{\n   \"Key\": \"?.,,./<>!@#$%^&*()_+-=\"\n}");
    
    finalize("Strings");


    printf("\nARRAYS\n");

    A.insert("Key", pretty_printer::prettify(vector<int>{1, 2, 3}));
    test("Int array", "{\n   \"Key\": [\n      1,\n      2,\n      3\n   ]\n}");

    A.insert("Key", pretty_printer::prettify(vector<int>{1, 2, 3}));
    A.insert("Key_2", pretty_printer::prettify(vector<int>{4, 5, 6}));
    test("Extra Int array", "{\n   \"Key\": [\n      1,\n      2,\n      3\n   ],\n   \"Key_2\": [\n      4,\n      5,\n      6\n   ]\n}");

    finalize("Arrays");
  

    printf("\nMISC\n");
    passed = total = 0;

    A.insert("Key", false);
    test("False", "{\n   \"Key\": false\n}");

    A.insert("Key", true);
    test("True", "{\n   \"Key\": true\n}");

    A.insert("Key");
    test("Null", "{\n   \"Key\": null\n}");

    finalize("Misc");

    printf("\nRECURSIVE\n");

    if (true) {
        map<string, int> map_test;
        map_test["abc"] = 2;

        A.insert("Key", map_test);
        test("Basic Map", "{\n   \"Key\": {\n      \"abc\": 2\n   }\n}");
    }

    if (true) {
        map<string, map<string, map<string, map<string, int>>>> map_test;
        map<string, int> i;
        i["first"] = 1;
        map<string, map<string, int>> j;
        j["second"] = i;
        map<string, map<string, map<string, int>>> k;
        k["third"] = j;

        map_test["out"] = k;

        test("Recursive Maps", "{\n   \"out\": {\n      \"third\": {\n         \"second\": {\n            \"first\": 1\n         }\n      }\n   }\n}", false, true, pretty_printer(map_test));
    }

    if (true) {
        map<string, map<string, map<string, map<string, int>>>> map_test;
        map<string, int> i;
        i["first"] = 1;
        map<string, int> l;
        l["other"] = 2;
        map<string, map<string, int>> j;
        j["second"] = i;
        j["other_second"] = l;
        map<string, map<string, map<string, int>>> k;
        k["third"] = j;

        map_test["out"] = k;

        test("Recursive Maps Extra", "{\n   \"out\": {\n      \"third\": {\n         \"other_second\": {\n            \"other\": 2\n         },\n         \"second\": {\n            \"first\": 1\n         }\n      }\n   }\n}", false, true, pretty_printer(map_test));
    }
    
    finalize("Recursive");

    printf("\nConsole\n");

    printf("\nNUMBERS\n");

    A.insert("Key", 0);
    test("Zero", "Key: 0", true);

    A.insert("Key", 1);
    test("Positive", "Key: 1", true);

    A.insert("Key", 14155324355633456215);
    test("Huge Positive", "Key: 14155324355633456215", true);

    A.insert("Key", 1234123423135321421);
    test("Large Positive", "Key: 1234123423135321421", true);

    A.insert("Key", -1234123423135321421);
    test("Large Negative", "Key: -1234123423135321421", true);

    A.insert("Key", 0.012321412);
    test("Positive Decimal", "Key: 0.01", true);

    A.insert("Key", -0.012321412);
    test("Negative Decimal", "Key: -0.01", true);

    A.insert("Key", 0.013242352532352343242321412);
    test("Large Positive Decimal", "Key: 0.01", true);

    A.insert("Key", -0.013242352532352343242321412);
    test("Large Negative Decimal", "Key: -0.01", true);

    finalize("Console Numbers");

    printf("\nSTRINGS\n");

    A.insert("Key", "abc");
    test("Basic String", "Key: abc", true);

    A.insert("Key", "AbvsaAYghsa");
    test("String Case", "Key: AbvsaAYghsa", true);

    A.insert("Key", 'a');
    test("Char", "Key: a", true);

    A.insert("Key", 'A');
    test("Char Capital", "Key: A", true);

    A.insert("Key", "'A'");
    test("Single Quotes", "Key: 'A'", true);

    A.insert("Key", "abc\\\"bc A\\\"");
    test("Double Quotes Extra", "Key: abc\\\"bc A\\\"", true);

    A.insert("Key", "dsffuighuyighsdzuifhuilhsteiryjuhhjklghuiosfhuisezhiulhgdiugtdhslkjhjhuxdghfkjdhdjkxlfhdsffuighuyighsdzuifhuilhsteiryjuhhjklghuiosfhuisezhiulhgdiugtdhslkjhjhuxdghfkjdhdjkxlfhdsffuighuyighsdzuifhuilhsteiryjuhhjklghuiosfhuisezhiulhgdiugtdhslkjhjhuxdghfkjdhdjkxlfhdsffuighuyighsdzuifhuilhsteiryjuhhjklghuiosfhuisezhiulhgdiugtdhslkjhjhuxdghfkjdhdjkxlfhdsffuighuyighsdzuifhuilhsteiryjuhhjklghuiosfhuisezhiulhgdiugtdhslkjhjhuxdghfkjdhdjkxlfhdsffuighuyighsdzuifhuilhsteiryjuhhjklghuiosfhuisezhiulhgdiugtdhslkjhjhuxdghfkjdhdjkxlfhdsffuighuyighsdzuifhuilhsteiryjuhhjklghuiosfhuisezhiulhgdiugtdhslkjhjhuxdghfkjdhdjkxlfhdsffuighuyighsdzuifhuilhsteiryjuhhjklghuiosfhuisezhiulhgdiugtdhslkjhjhuxdghfkjdhdjkxlfhdsffuighuyighsdzuifhuilhsteiryjuhhjklghuiosfhuisezhiulhgdiugtdhslkjhjhuxdghfkjdhdjkxlfhdsffuighuyighsdzuifhuilhsteiryjuhhjklghuiosfhuisezhiulhgdiugtdhslkjhjhuxdghfkjdhdjkxlfhdsffuighuyighsdzuifhuilhsteiryjuhhjklghuiosfhuisezhiulhgdiugtdhslkjhjhuxdghfkjdhdjkxlfhdsffuighuyighsdzuifhuilhsteiryjuhhjklghuiosfhuisezhiulhgdiugtdhslkjhjhuxdghfkjdhdjkxlfhdsffuighuyighsdzuifhuilhsteiryjuhhjklghuiosfhuisezhiulhgdiugtdhslkjhjhuxdghfkjdhdjkxlfhdsffuighuyighsdzuifhuilhsteiryjuhhjklghuiosfhuisezhiulhgdiugtdhslkjhjhuxdghfkjdhdjkxlfhdsffuighuyighsdzuifhuilhsteiryjuhhjklghuiosfhuisezhiulhgdiugtdhslkjhjhuxdghfkjdhdjkxlfhdsffuighuyighsdzuifhuilhsteiryjuhhjklghuiosfhuisezhiulhgdiugtdhslkjhjhuxdghfkjdhdjkxlfhdsffuighuyighsdzuifhuilhsteiryjuhhjklghuiosfhuisezhiulhgdiugtdhslkjhjhuxdghfkjdhdjkxlfhdsffuighuyighsdzuifhuilhsteiryjuhhjklghuiosfhuisezhiulhgdiugtdhslkjhjhuxdghfkjdhdjkxlfhdsffuighuyighsdzuifhuilhsteiryjuhhjklghuiosfhuisezhiulhgdiugtdhslkjhjhuxdghfkjdhdjkxlfhdsffuighuyighsdzuifhuilhsteiryjuhhjklghuiosfhuisezhiulhgdiugtdhslkjhjhuxdghfkjdhdjkxlfhdsffuighuyighsdzuifhuilhsteiryjuhhjklghuiosfhuisezhiulhgdiugtdhslkjhjhuxdghfkjdhdjkxlfhdsffuighuyighsdzuifhuilhsteiryjuhhjklghuiosfhuisezhiulhgdiugtdhslkjhjhuxdghfkjdhdjkxlfhdsffuighuyighsdzuifhuilhsteiryjuhhjklghuiosfhuisezhiulhgdiugtdhslkjhjhuxdghfkjdhdjkxlfhdsffuighuyighsdzuifhuilhsteiryjuhhjklghuiosfhuisezhiulhgdiugtdhslkjhjhuxdghfkjdhdjkxlfhdsffuighuyighsdzuifhuilhsteiryjuhhjklghuiosfhuisezhiulhgdiugtdhslkjhjhuxdghfkjdhdjkxlfhdsffuighuyighsdzuifhuilhsteiryjuhhjklghuiosfhuisezhiulhgdiugtdhslkjhjhuxdghfkjdhdjkxlfhdsffuighuyighsdzuifhuilhsteiryjuhhjklghuiosfhuisezhiulhgdiugtdhslkjhjhuxdghfkjdhdjkxlfhdsffuighuyighsdzuifhuilhsteiryjuhhjklghuiosfhuisezhiulhgdiugtdhslkjhjhuxdghfkjdhdjkxlfhdsffuighuyighsdzuifhuilhsteiryjuhhjklghuiosfhuisezhiulhgdiugtdhslkjhjhuxdghfkjdhdjkxlfhdsffuighuyighsdzuifhuilhsteiryjuhhjklghuiosfhuisezhiulhgdiugtdhslkjhjhuxdghfkjdhdjkxlfhdsffuighuyighsdzuifhuilhsteiryjuhhjklghuiosfhuisezhiulhgdiugtdhslkjhjhuxdghfkjdhdjkxlfhdsffuighuyighsdzuifhuilhsteiryjuhhjklghuiosfhuisezhiulhgdiugtdhslkjhjhuxdghfkjdhdjkxlfhdsffuighuyighsdzuifhuilhsteiryjuhhjklghuiosfhuisezhiulhgdiugtdhslkjhjhuxdghfkjdhdjkxlfhdsffuighuyighsdzuifhuilhsteiryjuhhjklghuiosfhuisezhiulhgdiugtdhslkjhjhuxdghfkjdhdjkxlfhdsffuighuyighsdzuifhuilhsteiryjuhhjklghuiosfhuisezhiulhgdiugtdhslkjhjhuxdghfkjdhdjkxlfhdsffuighuyighsdzuifhuilhsteiryjuhhjklghuiosfhuisezhiulhgdiugtdhslkjhjhuxdghfkjdhdjkxlfhdsffuighuyighsdzuifhuilhsteiryjuhhjklghuiosfhuisezhiulhgdiugtdhslkjhjhuxdghfkjdhdjkxlfhdsffuighuyighsdzuifhuilhsteiryjuhhjklghuiosfhuisezhiulhgdiugtdhslkjhjhuxdghfkjdhdjkxlfhdsffuighuyighsdzuifhuilhsteiryjuhhjklghuiosfhuisezhiulhgdiugtdhslkjhjhuxdghfkjdhdjkxlfhdsffuighuyighsdzuifhuilhsteiryjuhhjklghuiosfhuisezhiulhgdiugtdhslkjhjhuxdghfkjdhdjkxlfhdsffuighuyighsdzuifhuilhsteiryjuhhjklghuiosfhuisezhiulhgdiugtdhslkjhjhuxdghfkjdhdjkxlfhdsffuighuyighsdzuifhuilhsteiryjuhhjklghuiosfhuisezhiulhgdiugtdhslkjhjhuxdghfkjdhdjkxlfhdsffuighuyighsdzuifhuilhsteiryjuhhjklghuiosfhuisezhiulhgdiugtdhslkjhjhuxdghfkjdhdjkxlfhdsffuighuyighsdzuifhuilhsteiryjuhhjklghuiosfhuisezhiulhgdiugtdhslkjhjhuxdghfkjdhdjkxlfhdsffuighuyighsdzuifhuilhsteiryjuhhjklghuiosfhuisezhiulhgdiugtdhslkjhjhuxdghfkjdhdjkxlfhdsffuighuyighsdzuifhuilhsteiryjuhhjklghuiosfhuisezhiulhgdiugtdhslkjhjhuxdghfkjdhdjkxlfhdsffuighuyighsdzuifhuilhsteiryjuhhjklghuiosfhuisezhiulhgdiugtdhslkjhjhuxdghfkjdhdjkxlfhdsffuighuyighsdzuifhuilhsteiryjuhhjklghuiosfhuisezhiulhgdiugtdhslkjhjhuxdghfkjdhdjkxlfhdsffuighuyighsdzuifhuilhsteiryjuhhjklghuiosfhuisezhiulhgdiugtdhslkjhjhuxdghfkjdhdjkxlfhdsffuighuyighsdzuifhuilhsteiryjuhhjklghuiosfhuisezhiulhgdiugtdhslkjhjhuxdghfkjdhdjkxlfhdsffuighuyighsdzuifhuilhsteiryjuhhjklghuiosfhuisezhiulhgdiugtdhslkjhjhuxdghfkjdhdjkxlfhdsffuighuyighsdzuifhuilhsteiryjuhhjklghuiosfhuisezhiulhgdiugtdhslkjhjhuxdghfkjdhdjkxlfhdsffuighuyighsdzuifhuilhsteiryjuhhjklghuiosfhuisezhiulhgdiugtdhslkjhjhuxdghfkjdhdjkxlfhdsffuighuyighsdzuifhuilhsteiryjuhhjklghuiosfhuisezhiulhgdiugtdhslkjhjhuxdghfkjdhdjkxlfhdsffuighuyighsdzuifhuilhsteiryjuhhjklghuiosfhuisezhiulhgdiugtdhslkjhjhuxdghfkjdhdjkxlfhdsffuighuyighsdzuifhuilhsteiryjuhhjklghuiosfhuisezhiulhgdiugtdhslkjhjhuxdghfkjdhdjkxlfhdsffuighuyighsdzuifhuilhsteiryjuhhjklghuiosfhuisezhiulhgdiugtdhslkjhjhuxdghfkjdhdjkxlfhdsffuighuyighsdzuifhuilhsteiryjuhhjklghuiosfhuisezhiulhgdiugtdhslkjhjhuxdghfkjdhdjkxlfhdsffuighuyighsdzuifhuilhsteiryjuhhjklghuiosfhuisezhiulhgdiugtdhslkjhjhuxdghfkjdhdjkxlfhdsffuighuyighsdzuifhuilhsteiryjuhhjklghuiosfhuisezhiulhgdiugtdhslkjhjhuxdghfkjdhdjkxlfhdsffuighuyighsdzuifhuilhsteiryjuhhjklghuiosfhuisezhiulhgdiugtdhslkjhjhuxdghfkjdhdjkxlfhdsffuighuyighsdzuifhuilhsteiryjuhhjklghuiosfhuisezhiulhgdiugtdhslkjhjhuxdghfkjdhdjkxlfhdsffuighuyighsdzuifhuilhsteiryjuhhjklghuiosfhuisezhiulhgdiugtdhslkjhjhuxdghfkjdhdjkxlfhdsffuighuyighsdzuifhuilhsteiryjuhhjklghuiosfhuisezhiulhgdiugtdhslkjhjhuxdghfkjdhdjkxlfhdsffuighuyighsdzuifhuilhsteiryjuhhjklghuiosfhuisezhiulhgdiugtdhslkjhjhuxdghfkjdhdjkxlfhdsffuighuyighsdzuifhuilhsteiryjuhhjklghuiosfhuisezhiulhgdiugtdhslkjhjhuxdghfkjdhdjkxlfhdsffuighuyighsdzuifhuilhsteiryjuhhjklghuiosfhuisezhiulhgdiugtdhslkjhjhuxdghfkjdhdjkxlfhdsffuighuyighsdzuifhuilhsteiryjuhhjklghuiosfhuisezhiulhgdiugtdhslkjhjhuxdghfkjdhdjkxlfhdsffuighuyighsdzuifhuilhsteiryjuhhjklghuiosfhuisezhiulhgdiugtdhslkjhjhuxdghfkjdhdjkxlfhdsffuighuyighsdzuifhuilhsteiryjuhhjklghuiosfhuisezhiulhgdiugtdhslkjhjhuxdghfkjdhdjkxlfhdsffuighuyighsdzuifhuilhsteiryjuhhjklghuiosfhuisezhiulhgdiugtdhslkjhjhuxdghfkjdhdjkxlfhdsffuighuyighsdzuifhuilhsteiryjuhhjklghuiosfhuisezhiulhgdiugtdhslkjhjhuxdghfkjdhdjkxlfhdsffuighuyighsdzuifhuilhsteiryjuhhjklghuiosfhuisezhiulhgdiugtdhslkjhjhuxdghfkjdhdjkxlfhdsffuighuyighsdzuifhuilhsteiryjuhhjklghuiosfhuisezhiulhgdiugtdhslkjhjhuxdghfkjdhdjkxlfhdsffuighuyighsdzuifhuilhsteiryjuhhjklghuiosfhuisezhiulhgdiugtdhslkjhjhuxdghfkjdhdjkxlfhdsffuighuyighsdzuifhuilhsteiryjuhhjklghuiosfhuisezhiulhgdiugtdhslkjhjhuxdghfkjdhdjkxlfhdsffuighuyighsdzuifhuilhsteiryjuhhjklghuiosfhuisezhiulhgdiugtdhslkjhjhuxdghfkjdhdjkxlfhdsffuighuyighsdzuifhuilhsteiryjuhhjklghuiosfhuisezhiulhgdiugtdhslkjhjhuxdghfkjdhdjkxlfhdsffuighuyighsdzuifhuilhsteiryjuhhjklghuiosfhuisezhiulhgdiugtdhslkjhjhuxdghfkjdhdjkxlfhdsffuighuyighsdzuifhuilhsteiryjuhhjklghuiosfhuisezhiulhgdiugtdhslkjhjhuxdghfkjdhdjkxlfhdsffuighuyighsdzuifhuilhsteiryjuhhjklghuiosfhuisezhiulhgdiugtdhslkjhjhuxdghfkjdhdjkxlfhdsffuighuyighsdzuifhuilhsteiryjuhhjklghuiosfhuisezhiulhgdiugtdhslkjhjhuxdghfkjdhdjkxlfhdsffuighuyighsdzuifhuilhsteiryjuhhjklghuiosfhuisezhiulhgdiugtdhslkjhjhuxdghfkjdhdjkxlfhdsffuighuyighsdzuifhuilhsteiryjuhhjklghuiosfhuisezhiulhgdiugtdhslkjhjhuxdghfkjdhdjkxlfhdsffuighuyighsdzuifhuilhsteiryjuhhjklghuiosfhuisezhiulhgdiugtdhslkjhjhuxdghfkjdhdjkxlfhdsffuighuyighsdzuifhuilhsteiryjuhhjklghuiosfhuisezhiulhgdiugtdhslkjhjhuxdghfkjdhdjkxlfhdsffuighuyighsdzuifhuilhsteiryjuhhjklghuiosfhuisezhiulhgdiugtdhslkjhjhuxdghfkjdhdjkxlfhdsffuighuyighsdzuifhuilhsteiryjuhhjklghuiosfhuisezhiulhgdiugtdhslkjhjhuxdghfkjdhdjkxlfhdsffuighuyighsdzuifhuilhsteiryjuhhjklghuiosfhuisezhiulhgdiugtdhslkjhjhuxdghfkjdhdjkxlfhdsffuighuyighsdzuifhuilhsteiryjuhhjklghuiosfhuisezhiulhgdiugtdhslkjhjhuxdghfkjdhdjkxlfhdsffuighuyighsdzuifhuilhsteiryjuhhjklghuiosfhuisezhiulhgdiugtdhslkjhjhuxdghfkjdhdjkxlfhdsffuighuyighsdzuifhuilhsteiryjuhhjklghuiosfhuisezhiulhgdiugtdhslkjhjhuxdghfkjdhdjkxlfhdsffuighuyighsdzuifhuilhsteiryjuhhjklghuiosfhuisezhiulhgdiugtdhslkjhjhuxdghfkjdhdjkxlfhdsffuighuyighsdzuifhuilhsteiryjuhhjklghuiosfhuisezhiulhgdiugtdhslkjhjhuxdghfkjdhdjkxlfhdsffuighuyighsdzuifhuilhsteiryjuhhjklghuiosfhuisezhiulhgdiugtdhslkjhjhuxdghfkjdhdjkxlfhdsffuighuyighsdzuifhuilhsteiryjuhhjklghuiosfhuisezhiulhgdiugtdhslkjhjhuxdghfkjdhdjkxlfhdsffuighuyighsdzuifhuilhsteiryjuhhjklghuiosfhuisezhiulhgdiugtdhslkjhjhuxdghfkjdhdjkxlfhdsffuighuyighsdzuifhuilhsteiryjuhhjklghuiosfhuisezhiulhgdiugtdhslkjhjhuxdghfkjdhdjkxlfhdsffuighuyighsdzuifhuilhsteiryjuhhjklghuiosfhuisezhiulhgdiugtdhslkjhjhuxdghfkjdhdjkxlfhdsffuighuyighsdzuifhuilhsteiryjuhhjklghuiosfhuisezhiulhgdiugtdhslkjhjhuxdghfkjdhdjkxlfhdsffuighuyighsdzuifhuilhsteiryjuhhjklghuiosfhuisezhiulhgdiugtdhslkjhjhuxdghfkjdhdjkxlfhdsffuighuyighsdzuifhuilhsteiryjuhhjklghuiosfhuisezhiulhgdiugtdhslkjhjhuxdghfkjdhdjkxlfhdsffuighuyighsdzuifhuilhsteiryjuhhjklghuiosfhuisezhiulhgdiugtdhslkjhjhuxdghfkjdhdjkxlfhdsffuighuyighsdzuifhuilhsteiryjuhhjklghuiosfhuisezhiulhgdiugtdhslkjhjhuxdghfkjdhdjkxlfhdsffuighuyighsdzuifhuilhsteiryjuhhjklghuiosfhuisezhiulhgdiugtdhslkjhjhuxdghfkjdhdjkxlfhdsffuighuyighsdzuifhuilhsteiryjuhhjklghuiosfhuisezhiulhgdiugtdhslkjhjhuxdghfkjdhdjkxlfhdsffuighuyighsdzuifhuilhsteiryjuhhjklghuiosfhuisezhiulhgdiugtdhslkjhjhuxdghfkjdhdjkxlfhdsffuighuyighsdzuifhuilhsteiryjuhhjklghuiosfhuisezhiulhgdiugtdhslkjhjhuxdghfkjdhdjkxlfhdsffuighuyighsdzuifhuilhsteiryjuhhjklghuiosfhuisezhiulhgdiugtdhslkjhjhuxdghfkjdhdjkxlfhdsffuighuyighsdzuifhuilhsteiryjuhhjklghuiosfhuisezhiulhgdiugtdhslkjhjhuxdghfkjdhdjkxlfhdsffuighuyighsdzuifhuilhsteiryjuhhjklghuiosfhuisezhiulhgdiugtdhslkjhjhuxdghfkjdhdjkxlfhdsffuighuyighsdzuifhuilhsteiryjuhhjklghuiosfhuisezhiulhgdiugtdhslkjhjhuxdghfkjdhdjkxlfhdsffuighuyighsdzuifhuilhsteiryjuhhjklghuiosfhuisezhiulhgdiugtdhslkjhjhuxdghfkjdhdjkxlfhdsffuighuyighsdzuifhuilhsteiryjuhhjklghuiosfhuisezhiulhgdiugtdhslkjhjhuxdghfkjdhdjkxlfhdsffuighuyighsdzuifhuilhsteiryjuhhjklghuiosfhuisezhiulhgdiugtdhslkjhjhuxdghfkjdhdjkxlfhdsffuighuyighsdzuifhuilhsteiryjuhhjklghuiosfhuisezhiulhgdiugtdhslkjhjhuxdghfkjdhdjkxlfhdsffuighuyighsdzuifhuilhsteiryjuhhjklghuiosfhuisezhiulhgdiugtdhslkjhjhuxdghfkjdhdjkxlfhdsffuighuyighsdzuifhuilhsteiryjuhhjklghuiosfhuisezhiulhgdiugtdhslkjhjhuxdghfkjdhdjkxlfhdsffuighuyighsdzuifhuilhsteiryjuhhjklghuiosfhuisezhiulhgdiugtdhslkjhjhuxdghfkjdhdjkxlfhdsffuighuyighsdzuifhuilhsteiryjuhhjklghuiosfhuisezhiulhgdiugtdhslkjhjhuxdghfkjdhdjkxlfh");
    test("Very Long String", "Key: dsffuighuyighsdzuifhuilhsteiryjuhhjklghuiosfhuisezhiulhgdiugtdhslkjhjhuxdghfkjdhdjkxlfhdsffuighuyighsdzuifhuilhsteiryjuhhjklghuiosfhuisezhiulhgdiugtdhslkjhjhuxdghfkjdhdjkxlfhdsffuighuyighsdzuifhuilhsteiryjuhhjklghuiosfhuisezhiulhgdiugtdhslkjhjhuxdghfkjdhdjkxlfhdsffuighuyighsdzuifhuilhsteiryjuhhjklghuiosfhuisezhiulhgdiugtdhslkjhjhuxdghfkjdhdjkxlfhdsffuighuyighsdzuifhuilhsteiryjuhhjklghuiosfhuisezhiulhgdiugtdhslkjhjhuxdghfkjdhdjkxlfhdsffuighuyighsdzuifhuilhsteiryjuhhjklghuiosfhuisezhiulhgdiugtdhslkjhjhuxdghfkjdhdjkxlfhdsffuighuyighsdzuifhuilhsteiryjuhhjklghuiosfhuisezhiulhgdiugtdhslkjhjhuxdghfkjdhdjkxlfhdsffuighuyighsdzuifhuilhsteiryjuhhjklghuiosfhuisezhiulhgdiugtdhslkjhjhuxdghfkjdhdjkxlfhdsffuighuyighsdzuifhuilhsteiryjuhhjklghuiosfhuisezhiulhgdiugtdhslkjhjhuxdghfkjdhdjkxlfhdsffuighuyighsdzuifhuilhsteiryjuhhjklghuiosfhuisezhiulhgdiugtdhslkjhjhuxdghfkjdhdjkxlfhdsffuighuyighsdzuifhuilhsteiryjuhhjklghuiosfhuisezhiulhgdiugtdhslkjhjhuxdghfkjdhdjkxlfhdsffuighuyighsdzuifhuilhsteiryjuhhjklghuiosfhuisezhiulhgdiugtdhslkjhjhuxdghfkjdhdjkxlfhdsffuighuyighsdzuifhuilhsteiryjuhhjklghuiosfhuisezhiulhgdiugtdhslkjhjhuxdghfkjdhdjkxlfhdsffuighuyighsdzuifhuilhsteiryjuhhjklghuiosfhuisezhiulhgdiugtdhslkjhjhuxdghfkjdhdjkxlfhdsffuighuyighsdzuifhuilhsteiryjuhhjklghuiosfhuisezhiulhgdiugtdhslkjhjhuxdghfkjdhdjkxlfhdsffuighuyighsdzuifhuilhsteiryjuhhjklghuiosfhuisezhiulhgdiugtdhslkjhjhuxdghfkjdhdjkxlfhdsffuighuyighsdzuifhuilhsteiryjuhhjklghuiosfhuisezhiulhgdiugtdhslkjhjhuxdghfkjdhdjkxlfhdsffuighuyighsdzuifhuilhsteiryjuhhjklghuiosfhuisezhiulhgdiugtdhslkjhjhuxdghfkjdhdjkxlfhdsffuighuyighsdzuifhuilhsteiryjuhhjklghuiosfhuisezhiulhgdiugtdhslkjhjhuxdghfkjdhdjkxlfhdsffuighuyighsdzuifhuilhsteiryjuhhjklghuiosfhuisezhiulhgdiugtdhslkjhjhuxdghfkjdhdjkxlfhdsffuighuyighsdzuifhuilhsteiryjuhhjklghuiosfhuisezhiulhgdiugtdhslkjhjhuxdghfkjdhdjkxlfhdsffuighuyighsdzuifhuilhsteiryjuhhjklghuiosfhuisezhiulhgdiugtdhslkjhjhuxdghfkjdhdjkxlfhdsffuighuyighsdzuifhuilhsteiryjuhhjklghuiosfhuisezhiulhgdiugtdhslkjhjhuxdghfkjdhdjkxlfhdsffuighuyighsdzuifhuilhsteiryjuhhjklghuiosfhuisezhiulhgdiugtdhslkjhjhuxdghfkjdhdjkxlfhdsffuighuyighsdzuifhuilhsteiryjuhhjklghuiosfhuisezhiulhgdiugtdhslkjhjhuxdghfkjdhdjkxlfhdsffuighuyighsdzuifhuilhsteiryjuhhjklghuiosfhuisezhiulhgdiugtdhslkjhjhuxdghfkjdhdjkxlfhdsffuighuyighsdzuifhuilhsteiryjuhhjklghuiosfhuisezhiulhgdiugtdhslkjhjhuxdghfkjdhdjkxlfhdsffuighuyighsdzuifhuilhsteiryjuhhjklghuiosfhuisezhiulhgdiugtdhslkjhjhuxdghfkjdhdjkxlfhdsffuighuyighsdzuifhuilhsteiryjuhhjklghuiosfhuisezhiulhgdiugtdhslkjhjhuxdghfkjdhdjkxlfhdsffuighuyighsdzuifhuilhsteiryjuhhjklghuiosfhuisezhiulhgdiugtdhslkjhjhuxdghfkjdhdjkxlfhdsffuighuyighsdzuifhuilhsteiryjuhhjklghuiosfhuisezhiulhgdiugtdhslkjhjhuxdghfkjdhdjkxlfhdsffuighuyighsdzuifhuilhsteiryjuhhjklghuiosfhuisezhiulhgdiugtdhslkjhjhuxdghfkjdhdjkxlfhdsffuighuyighsdzuifhuilhsteiryjuhhjklghuiosfhuisezhiulhgdiugtdhslkjhjhuxdghfkjdhdjkxlfhdsffuighuyighsdzuifhuilhsteiryjuhhjklghuiosfhuisezhiulhgdiugtdhslkjhjhuxdghfkjdhdjkxlfhdsffuighuyighsdzuifhuilhsteiryjuhhjklghuiosfhuisezhiulhgdiugtdhslkjhjhuxdghfkjdhdjkxlfhdsffuighuyighsdzuifhuilhsteiryjuhhjklghuiosfhuisezhiulhgdiugtdhslkjhjhuxdghfkjdhdjkxlfhdsffuighuyighsdzuifhuilhsteiryjuhhjklghuiosfhuisezhiulhgdiugtdhslkjhjhuxdghfkjdhdjkxlfhdsffuighuyighsdzuifhuilhsteiryjuhhjklghuiosfhuisezhiulhgdiugtdhslkjhjhuxdghfkjdhdjkxlfhdsffuighuyighsdzuifhuilhsteiryjuhhjklghuiosfhuisezhiulhgdiugtdhslkjhjhuxdghfkjdhdjkxlfhdsffuighuyighsdzuifhuilhsteiryjuhhjklghuiosfhuisezhiulhgdiugtdhslkjhjhuxdghfkjdhdjkxlfhdsffuighuyighsdzuifhuilhsteiryjuhhjklghuiosfhuisezhiulhgdiugtdhslkjhjhuxdghfkjdhdjkxlfhdsffuighuyighsdzuifhuilhsteiryjuhhjklghuiosfhuisezhiulhgdiugtdhslkjhjhuxdghfkjdhdjkxlfhdsffuighuyighsdzuifhuilhsteiryjuhhjklghuiosfhuisezhiulhgdiugtdhslkjhjhuxdghfkjdhdjkxlfhdsffuighuyighsdzuifhuilhsteiryjuhhjklghuiosfhuisezhiulhgdiugtdhslkjhjhuxdghfkjdhdjkxlfhdsffuighuyighsdzuifhuilhsteiryjuhhjklghuiosfhuisezhiulhgdiugtdhslkjhjhuxdghfkjdhdjkxlfhdsffuighuyighsdzuifhuilhsteiryjuhhjklghuiosfhuisezhiulhgdiugtdhslkjhjhuxdghfkjdhdjkxlfhdsffuighuyighsdzuifhuilhsteiryjuhhjklghuiosfhuisezhiulhgdiugtdhslkjhjhuxdghfkjdhdjkxlfhdsffuighuyighsdzuifhuilhsteiryjuhhjklghuiosfhuisezhiulhgdiugtdhslkjhjhuxdghfkjdhdjkxlfhdsffuighuyighsdzuifhuilhsteiryjuhhjklghuiosfhuisezhiulhgdiugtdhslkjhjhuxdghfkjdhdjkxlfhdsffuighuyighsdzuifhuilhsteiryjuhhjklghuiosfhuisezhiulhgdiugtdhslkjhjhuxdghfkjdhdjkxlfhdsffuighuyighsdzuifhuilhsteiryjuhhjklghuiosfhuisezhiulhgdiugtdhslkjhjhuxdghfkjdhdjkxlfhdsffuighuyighsdzuifhuilhsteiryjuhhjklghuiosfhuisezhiulhgdiugtdhslkjhjhuxdghfkjdhdjkxlfhdsffuighuyighsdzuifhuilhsteiryjuhhjklghuiosfhuisezhiulhgdiugtdhslkjhjhuxdghfkjdhdjkxlfhdsffuighuyighsdzuifhuilhsteiryjuhhjklghuiosfhuisezhiulhgdiugtdhslkjhjhuxdghfkjdhdjkxlfhdsffuighuyighsdzuifhuilhsteiryjuhhjklghuiosfhuisezhiulhgdiugtdhslkjhjhuxdghfkjdhdjkxlfhdsffuighuyighsdzuifhuilhsteiryjuhhjklghuiosfhuisezhiulhgdiugtdhslkjhjhuxdghfkjdhdjkxlfhdsffuighuyighsdzuifhuilhsteiryjuhhjklghuiosfhuisezhiulhgdiugtdhslkjhjhuxdghfkjdhdjkxlfhdsffuighuyighsdzuifhuilhsteiryjuhhjklghuiosfhuisezhiulhgdiugtdhslkjhjhuxdghfkjdhdjkxlfhdsffuighuyighsdzuifhuilhsteiryjuhhjklghuiosfhuisezhiulhgdiugtdhslkjhjhuxdghfkjdhdjkxlfhdsffuighuyighsdzuifhuilhsteiryjuhhjklghuiosfhuisezhiulhgdiugtdhslkjhjhuxdghfkjdhdjkxlfhdsffuighuyighsdzuifhuilhsteiryjuhhjklghuiosfhuisezhiulhgdiugtdhslkjhjhuxdghfkjdhdjkxlfhdsffuighuyighsdzuifhuilhsteiryjuhhjklghuiosfhuisezhiulhgdiugtdhslkjhjhuxdghfkjdhdjkxlfhdsffuighuyighsdzuifhuilhsteiryjuhhjklghuiosfhuisezhiulhgdiugtdhslkjhjhuxdghfkjdhdjkxlfhdsffuighuyighsdzuifhuilhsteiryjuhhjklghuiosfhuisezhiulhgdiugtdhslkjhjhuxdghfkjdhdjkxlfhdsffuighuyighsdzuifhuilhsteiryjuhhjklghuiosfhuisezhiulhgdiugtdhslkjhjhuxdghfkjdhdjkxlfhdsffuighuyighsdzuifhuilhsteiryjuhhjklghuiosfhuisezhiulhgdiugtdhslkjhjhuxdghfkjdhdjkxlfhdsffuighuyighsdzuifhuilhsteiryjuhhjklghuiosfhuisezhiulhgdiugtdhslkjhjhuxdghfkjdhdjkxlfhdsffuighuyighsdzuifhuilhsteiryjuhhjklghuiosfhuisezhiulhgdiugtdhslkjhjhuxdghfkjdhdjkxlfhdsffuighuyighsdzuifhuilhsteiryjuhhjklghuiosfhuisezhiulhgdiugtdhslkjhjhuxdghfkjdhdjkxlfhdsffuighuyighsdzuifhuilhsteiryjuhhjklghuiosfhuisezhiulhgdiugtdhslkjhjhuxdghfkjdhdjkxlfhdsffuighuyighsdzuifhuilhsteiryjuhhjklghuiosfhuisezhiulhgdiugtdhslkjhjhuxdghfkjdhdjkxlfhdsffuighuyighsdzuifhuilhsteiryjuhhjklghuiosfhuisezhiulhgdiugtdhslkjhjhuxdghfkjdhdjkxlfhdsffuighuyighsdzuifhuilhsteiryjuhhjklghuiosfhuisezhiulhgdiugtdhslkjhjhuxdghfkjdhdjkxlfhdsffuighuyighsdzuifhuilhsteiryjuhhjklghuiosfhuisezhiulhgdiugtdhslkjhjhuxdghfkjdhdjkxlfhdsffuighuyighsdzuifhuilhsteiryjuhhjklghuiosfhuisezhiulhgdiugtdhslkjhjhuxdghfkjdhdjkxlfhdsffuighuyighsdzuifhuilhsteiryjuhhjklghuiosfhuisezhiulhgdiugtdhslkjhjhuxdghfkjdhdjkxlfhdsffuighuyighsdzuifhuilhsteiryjuhhjklghuiosfhuisezhiulhgdiugtdhslkjhjhuxdghfkjdhdjkxlfhdsffuighuyighsdzuifhuilhsteiryjuhhjklghuiosfhuisezhiulhgdiugtdhslkjhjhuxdghfkjdhdjkxlfhdsffuighuyighsdzuifhuilhsteiryjuhhjklghuiosfhuisezhiulhgdiugtdhslkjhjhuxdghfkjdhdjkxlfhdsffuighuyighsdzuifhuilhsteiryjuhhjklghuiosfhuisezhiulhgdiugtdhslkjhjhuxdghfkjdhdjkxlfhdsffuighuyighsdzuifhuilhsteiryjuhhjklghuiosfhuisezhiulhgdiugtdhslkjhjhuxdghfkjdhdjkxlfhdsffuighuyighsdzuifhuilhsteiryjuhhjklghuiosfhuisezhiulhgdiugtdhslkjhjhuxdghfkjdhdjkxlfhdsffuighuyighsdzuifhuilhsteiryjuhhjklghuiosfhuisezhiulhgdiugtdhslkjhjhuxdghfkjdhdjkxlfhdsffuighuyighsdzuifhuilhsteiryjuhhjklghuiosfhuisezhiulhgdiugtdhslkjhjhuxdghfkjdhdjkxlfhdsffuighuyighsdzuifhuilhsteiryjuhhjklghuiosfhuisezhiulhgdiugtdhslkjhjhuxdghfkjdhdjkxlfhdsffuighuyighsdzuifhuilhsteiryjuhhjklghuiosfhuisezhiulhgdiugtdhslkjhjhuxdghfkjdhdjkxlfhdsffuighuyighsdzuifhuilhsteiryjuhhjklghuiosfhuisezhiulhgdiugtdhslkjhjhuxdghfkjdhdjkxlfhdsffuighuyighsdzuifhuilhsteiryjuhhjklghuiosfhuisezhiulhgdiugtdhslkjhjhuxdghfkjdhdjkxlfhdsffuighuyighsdzuifhuilhsteiryjuhhjklghuiosfhuisezhiulhgdiugtdhslkjhjhuxdghfkjdhdjkxlfhdsffuighuyighsdzuifhuilhsteiryjuhhjklghuiosfhuisezhiulhgdiugtdhslkjhjhuxdghfkjdhdjkxlfhdsffuighuyighsdzuifhuilhsteiryjuhhjklghuiosfhuisezhiulhgdiugtdhslkjhjhuxdghfkjdhdjkxlfhdsffuighuyighsdzuifhuilhsteiryjuhhjklghuiosfhuisezhiulhgdiugtdhslkjhjhuxdghfkjdhdjkxlfhdsffuighuyighsdzuifhuilhsteiryjuhhjklghuiosfhuisezhiulhgdiugtdhslkjhjhuxdghfkjdhdjkxlfhdsffuighuyighsdzuifhuilhsteiryjuhhjklghuiosfhuisezhiulhgdiugtdhslkjhjhuxdghfkjdhdjkxlfhdsffuighuyighsdzuifhuilhsteiryjuhhjklghuiosfhuisezhiulhgdiugtdhslkjhjhuxdghfkjdhdjkxlfhdsffuighuyighsdzuifhuilhsteiryjuhhjklghuiosfhuisezhiulhgdiugtdhslkjhjhuxdghfkjdhdjkxlfhdsffuighuyighsdzuifhuilhsteiryjuhhjklghuiosfhuisezhiulhgdiugtdhslkjhjhuxdghfkjdhdjkxlfhdsffuighuyighsdzuifhuilhsteiryjuhhjklghuiosfhuisezhiulhgdiugtdhslkjhjhuxdghfkjdhdjkxlfhdsffuighuyighsdzuifhuilhsteiryjuhhjklghuiosfhuisezhiulhgdiugtdhslkjhjhuxdghfkjdhdjkxlfhdsffuighuyighsdzuifhuilhsteiryjuhhjklghuiosfhuisezhiulhgdiugtdhslkjhjhuxdghfkjdhdjkxlfhdsffuighuyighsdzuifhuilhsteiryjuhhjklghuiosfhuisezhiulhgdiugtdhslkjhjhuxdghfkjdhdjkxlfhdsffuighuyighsdzuifhuilhsteiryjuhhjklghuiosfhuisezhiulhgdiugtdhslkjhjhuxdghfkjdhdjkxlfhdsffuighuyighsdzuifhuilhsteiryjuhhjklghuiosfhuisezhiulhgdiugtdhslkjhjhuxdghfkjdhdjkxlfhdsffuighuyighsdzuifhuilhsteiryjuhhjklghuiosfhuisezhiulhgdiugtdhslkjhjhuxdghfkjdhdjkxlfhdsffuighuyighsdzuifhuilhsteiryjuhhjklghuiosfhuisezhiulhgdiugtdhslkjhjhuxdghfkjdhdjkxlfhdsffuighuyighsdzuifhuilhsteiryjuhhjklghuiosfhuisezhiulhgdiugtdhslkjhjhuxdghfkjdhdjkxlfhdsffuighuyighsdzuifhuilhsteiryjuhhjklghuiosfhuisezhiulhgdiugtdhslkjhjhuxdghfkjdhdjkxlfhdsffuighuyighsdzuifhuilhsteiryjuhhjklghuiosfhuisezhiulhgdiugtdhslkjhjhuxdghfkjdhdjkxlfhdsffuighuyighsdzuifhuilhsteiryjuhhjklghuiosfhuisezhiulhgdiugtdhslkjhjhuxdghfkjdhdjkxlfhdsffuighuyighsdzuifhuilhsteiryjuhhjklghuiosfhuisezhiulhgdiugtdhslkjhjhuxdghfkjdhdjkxlfhdsffuighuyighsdzuifhuilhsteiryjuhhjklghuiosfhuisezhiulhgdiugtdhslkjhjhuxdghfkjdhdjkxlfhdsffuighuyighsdzuifhuilhsteiryjuhhjklghuiosfhuisezhiulhgdiugtdhslkjhjhuxdghfkjdhdjkxlfhdsffuighuyighsdzuifhuilhsteiryjuhhjklghuiosfhuisezhiulhgdiugtdhslkjhjhuxdghfkjdhdjkxlfhdsffuighuyighsdzuifhuilhsteiryjuhhjklghuiosfhuisezhiulhgdiugtdhslkjhjhuxdghfkjdhdjkxlfhdsffuighuyighsdzuifhuilhsteiryjuhhjklghuiosfhuisezhiulhgdiugtdhslkjhjhuxdghfkjdhdjkxlfhdsffuighuyighsdzuifhuilhsteiryjuhhjklghuiosfhuisezhiulhgdiugtdhslkjhjhuxdghfkjdhdjkxlfhdsffuighuyighsdzuifhuilhsteiryjuhhjklghuiosfhuisezhiulhgdiugtdhslkjhjhuxdghfkjdhdjkxlfhdsffuighuyighsdzuifhuilhsteiryjuhhjklghuiosfhuisezhiulhgdiugtdhslkjhjhuxdghfkjdhdjkxlfhdsffuighuyighsdzuifhuilhsteiryjuhhjklghuiosfhuisezhiulhgdiugtdhslkjhjhuxdghfkjdhdjkxlfhdsffuighuyighsdzuifhuilhsteiryjuhhjklghuiosfhuisezhiulhgdiugtdhslkjhjhuxdghfkjdhdjkxlfh", true);

    A.insert("Key", "?.,,./<>!@#$%^&*()_+-=");
    test("Special Characters", "Key: ?.,,./<>!@#$%^&*()_+-=", true);

    finalize("Console Strings");


    printf("\nARRAYS\n");

    A.insert("Key", pretty_printer::prettify(vector<int>{1, 2, 3}));
    test("Int array", "Key:\n   1\n   2\n   3", true);

    A.insert("Key", pretty_printer::prettify(vector<int>{1, 2, 3}));
    A.insert("Key_2", pretty_printer::prettify(vector<int>{4, 5, 6}));
    test("Extra Int array", "Key:\n   1\n   2\n   3\nKey_2:\n   4\n   5\n   6", true);

    finalize("Console Arrays");


    printf("\nMISC\n");

    A.insert("Key", false);
    test("False", "Key: false", true);

    A.insert("Key", true);
    test("True", "Key: true", true);

    A.insert("Key");
    test("Null", "Key: null", true);

    finalize("Console Misc");



    printf("\nRECURSIVE\n");

    if (true) {
        map<string, int> map_test;
        map_test["abc"] = 2;

        A.insert("Key", map_test);
        test("Basic Map", "Key:\n   abc: 2", true);
    }

    if (true) {
        map<string, map<string, map<string, map<string, int>>>> map_test;
        map<string, int> i;
        i["first"] = 1;
        map<string, map<string, int>> j;
        j["second"] = i;
        map<string, map<string, map<string, int>>> k;
        k["third"] = j;

        map_test["out"] = k;

        test("Recursive Maps", "out:\n   third:\n      second:\n         first: 1", true, true, pretty_printer(map_test));
    }

    if (true) {
        map<string, map<string, map<string, map<string, int>>>> map_test;
        map<string, int> i;
        i["first"] = 1;
        map<string, int> l;
        l["other"] = 2;
        map<string, map<string, int>> j;
        j["second"] = i;
        j["other_second"] = l;
        map<string, map<string, map<string, int>>> k;
        k["third"] = j;

        map_test["out"] = k;

        test("Recursive Maps Extra", "out:\n   third:\n      other_second:\n         other: 2\n      second:\n         first: 1", true, true, pretty_printer(map_test));
    }


    finalize("Console Recursive");

    // Display results
    printf("\n");
    for (auto& suite : order) {
        auto& result = results[suite];
        printf("%s - Passed: %d/%d\n", suite.c_str(), result.first, result.second);
    }

    const double success = static_cast<const double>(all_passed) / all_total * 100;
    printf("\nTests Passed: %d/%d - %.2f%%", all_passed, all_total, success);

    if (all_passed != all_total) {
        printf(" (%d Failed)", all_total - all_passed);
    }

    printf("\n");

    return 0;
}
