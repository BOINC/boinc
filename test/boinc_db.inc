<?php
    // Generated by db_def_to_php
    define("LARGE_BLOB_SIZE", 65536);
    define("TEAM_TYPE_CLUB", 1);
    define("TEAM_TYPE_COMPANY", 2);
    define("TEAM_TYPE_PRIMARY", 3);
    define("TEAM_TYPE_SECONDARY", 4);
    define("TEAM_TYPE_JUNIOR_COLLEGE", 5);
    define("TEAM_TYPE_UNIVERSITY", 6);
    define("TEAM_TYPE_GOVERNMENT", 7);
    define("FILE_DELETE_INIT", 0);
    define("FILE_DELETE_READY", 1);
    define("FILE_DELETE_DONE", 2);
    define("ASSIMILATE_INIT", 0);
    define("ASSIMILATE_READY", 1);
    define("ASSIMILATE_DONE", 2);
    define("WU_ERROR_COULDNT_SEND_RESULT", 1);
    define("WU_ERROR_TOO_MANY_ERROR_RESULTS", 2);
    define("WU_ERROR_TOO_MANY_SUCCESS_RESULTS", 4);
    define("WU_ERROR_TOO_MANY_TOTAL_RESULTS", 8);
    define("RESULT_SERVER_STATE_INACTIVE", 1);
    define("RESULT_SERVER_STATE_UNSENT", 2);
    define("RESULT_SERVER_STATE_UNSENT_SEQ", 3);
    define("RESULT_SERVER_STATE_IN_PROGRESS", 4);
    define("RESULT_SERVER_STATE_OVER", 5);
    define("RESULT_OUTCOME_INIT", 0);
    define("RESULT_OUTCOME_SUCCESS", 1);
    define("RESULT_OUTCOME_COULDNT_SEND", 2);
    define("RESULT_OUTCOME_CLIENT_ERROR", 3);
    define("RESULT_OUTCOME_NO_REPLY", 4);
    define("RESULT_OUTCOME_DIDNT_NEED", 5);
    define("VALIDATE_STATE_INIT", 0);
    define("VALIDATE_STATE_VALID", 1);
    define("VALIDATE_STATE_INVALID", 2);
    define("VALIDATE_STATE_NO_CHECK", 3);
    define("RESULT_NEW", 0);
    define("RESULT_FILES_DOWNLOADING", 1);
    define("RESULT_FILES_DOWNLOADED", 2);
    define("RESULT_COMPUTE_DONE", 3);
    define("RESULT_FILES_UPLOADING", 4);
    define("RESULT_FILES_UPLOADED", 5);
?>
